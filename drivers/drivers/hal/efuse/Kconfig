## kernel/liteos/Kconfig
```kconfig
#===============================================================================
# @brief    Kconfig file.
# Copyright (c) HiSilicon (Shanghai) Technologies Co., Ltd. 2023-2023. All rights reserved.
#===============================================================================
config DRIVER_SUPPORT_LITEOS_208_6_0_B017_CAT1
    bool
    prompt "LiteOS_208_6_0_B017_CAT1"
    default n
    help
        This option means support LiteOS_208_6_0.
    depends on DRIVER_SUPPORT_LITEOS

if DRIVER_SUPPORT_LITEOS_208_6_0_B017_CAT1
    osource "kernel/liteos/liteos_v208.6.0_b017_cat1/Kconfig"
endif

config DRIVER_SUPPORT_LITEOS_208_6_0_B017
    bool
    prompt "LiteOS_208_6_0_B017"
    default n
    help
        This option means support LiteOS_208_6_0.
    depends on DRIVER_SUPPORT_LITEOS

if DRIVER_SUPPORT_LITEOS_208_6_0_B017
    osource "kernel/liteos/liteos_v208.6.0_b017/Kconfig"
endif

config DRIVER_SUPPORT_LITEOS_208_5_0_B004
    bool
    prompt "LiteOS_208_5_0_B004"
    default n
    help
        This option means support LiteOS_208_5_0.
    depends on DRIVER_SUPPORT_LITEOS

if DRIVER_SUPPORT_LITEOS_208_5_0
    osource "kernel/liteos/liteos_v208.5.0_b004/Kconfig"
endif

config DRIVER_SUPPORT_LITEOS_208_5_0
    bool
    prompt "LiteOS_208_5_0"
    default n
    help
        This option means support LiteOS_208_5_0.
    depends on DRIVER_SUPPORT_LITEOS

if DRIVER_SUPPORT_LITEOS_208_5_0
    osource "kernel/liteos/liteos_v208.5.0/Kconfig"
endif

config DRIVER_SUPPORT_LITEOS_207_0_0
    bool
    prompt "LiteOS_207_0_0"
    default y
    help
        This option means support LiteOS_207_0_0.
    depends on DRIVER_SUPPORT_LITEOS

if DRIVER_SUPPORT_LITEOS_207_0_0
    osource "kernel/liteos/liteos_v207.0.0/Kconfig"
endif
```

## kernel/liteos/liteos_v208.5.0/Huawei_LiteOS/arch/Kconfig
```kconfig
# Copyright (c) Huawei Technologies Co., Ltd. 2019-2020. All rights reserved.

config LOSCFG_ARCH_FPU_ENABLE
    bool "Enable Floating Pointer Unit"
    default y
    depends on LOSCFG_ARCH_CORTEX_M4 || LOSCFG_ARCH_CORTEX_M7 || LOSCFG_ARCH_ARM_AARCH32 || LOSCFG_ARCH_ARM_AARCH64 || LOSCFG_ARCH_RISCV_RV32F || LOSCFG_ARCH_LINGLONG
    help
      This option will bypass floating procedure in system.

config LOSCFG_ARCH_FPU_DOUBLE
    bool "Use 'D' Standard Extension"
    default n
    depends on LOSCFG_ARCH_RISCV_RV32D && LOSCFG_ARCH_FPU_ENABLE && LOSCFG_ARCH_LINX_M
    help
      adds double-precision floating-point computational instructions compile.

choice
    prompt "FPU Mode"
    default LOSCFG_ARCH_FPU_SOFTFP
    # The FPU Mode Option Not Supported In Riscv
    depends on LOSCFG_ARCH_FPU_ENABLE && !LOSCFG_ARCH_RISCV_RV32F
    help
      The FPU mode for compiler.

config LOSCFG_ARCH_FPU_SOFTFP
    bool "Use Mode softfp"
    # AArch64 has no specific FPU compile options like AArch32 does.
    depends on LOSCFG_ARCH_ARM_AARCH32
    help
      Choose "-mfloat-abi=softfp" for compiler.

config LOSCFG_ARCH_FPU_HARD
    bool "Use Mode hard"
    help
      Choose "-mfloat-abi=hard" for compiler.

endchoice

config LOSCFG_ARCH_SECURE_MONITOR_MODE
    bool "Run On Secure Monitor Mode"
    default n
    depends on LOSCFG_ARCH_ARM_AARCH64
    help
      This option will make the system run on EL3.

config LOSCFG_APC_ENABLE
    bool "Enable Access Permission Control"
    default y
    help
      This option will Enable Access Permission Control

config LOSCFG_FPB_ENABLE
    bool "Enable Flash Patch"
    default n
    depends on LOSCFG_ARCH_ARM_CORTEX_M || LOSCFG_ARCH_LINXCORE_131
    help
      Answer Y to enable LiteOS to support Flash Patch

config RISCV_FPB_SET_PCO
    bool "Enable patch offset bigger than 1M"
    default y
    depends on LOSCFG_ARCH_RISCV32 && LOSCFG_FPB_ENABLE
    help
      Enable patch offset bigger than 1M by Set PCO(patch code branch offset) bit

config LOSCFG_LIB_CONFIGURABLE
    bool
    default n
    help
      Answer Y to enable LiteOS to support base kernel lib configurable

config LOSCFG_MULTI_BINARIES
    bool
    default n
    select LOSCFG_LIB_CONFIGURABLE
    help
      Answer Y to enable LiteOS to support multi binaries

config LOSCFG_ARCH_SOUP_ENABLE
    bool "Enable Hardware Stack Overflow/Underflow Protection (SOUP)"
    default y
    depends on LOSCFG_ARCH_LINGLONG && LOSCFG_ARCH_INTERRUPT_TAKEOVER
    help
      This option enables SOUP support.

config LOSCFG_ARCH_PMU
    bool
    default n
    help
      This option indicates the PMU implemented by hardware.

osource "arch/common/Kconfig"
osource "arch/arm/Kconfig"
osource "arch/arm64/Kconfig"
osource "arch/xtensa/Kconfig"
osource "arch/riscv/Kconfig"
osource "arch/linglong/Kconfig"
```

## kernel/liteos/liteos_v208.5.0/Huawei_LiteOS/arch/common/Kconfig
```kconfig
config LOSCFG_ARCH_MMU_ENABLE
    bool "Enable mmu"
    depends on LOSCFG_APC_ENABLE && (LOSCFG_ARCH_ARM_CORTEX_A || LOSCFG_ARCH_ARM_AARCH64)
    help 
      This option will enable Memory Management Unit(MMU).

config LOSCFG_ARCH_MMU_VA_MANAGE
    bool "Support Virtual Address Management"
    default n
    depends on LOSCFG_ARCH_MMU_ENABLE
    help 
        Specifies whether to support unified management of virtual addresses. 
        Virtual addresses and physical addresses can be different.
config LOSCFG_ARCH_MMU_PAGE_TBL_NUM
    int "Number of MMU page tables"
    default 512
    depends on LOSCFG_ARCH_MMU_ENABLE
```

## kernel/liteos/liteos_v208.5.0/Huawei_LiteOS/arch/riscv/Kconfig
```kconfig
# RISC-V Architecture
config LOSCFG_ARCH_RISCV32
    bool
    help
      This is used to distinguish architecture.

config LOSCFG_ARCH_RISCV_RV32IMC
    bool
    select LOSCFG_ARCH_PMU
    help
      32-bit RISCV architecture implementations.

config LOSCFG_ARCH_RISCV_RV32F
    bool
    help
      32-bit RISCV FPU architecture implementations.

config LOSCFG_ARCH_RISCV_RV32D
    bool
    select LOSCFG_ARCH_RISCV_RV32F
    help
      32-bit RISCV Double-Precision Floating-Point.

config LOSCFG_LCMP_CUSTOM_INST16_EXTENSIONS
    bool
    help
      This is an extra custom extension for RISC-V standard C-extension. It depend on LOSCFG_ARCH_LINX_M.
      This extension includes some 16-bit custom instructions for:
      - arithmetic logic operations - byte/half-word sign/zero-extension operations
      - store zero to memory operations - push/pop operations

config LOSCFG_LCMP_CUSTOM_INST16_SUB_EXTENSIONS
    bool
    help
      This is also an extra custom extension for RISC-V standard C-extension. It depend on LOSCFG_ARCH_LINX_M.
      This custom extension has encoding conflicts with the RISC-V standard C-extension.
      It can not be enabled when the RISC-V standard C-extension and D-extension are configured at the same time.
      This extension includes some 16-bit custom instructions for:
      - load/store byte/half-word operations

config LOSCFG_LCMP_CUSTOM_INST32_EXTENSIONS
    bool
    help
      These custom instructions use custom encoding space or follow RISC-V standard extension encoding. It depend on LOSCFG_ARCH_LINX_M.
      This extension provides some 32-bit custom instructions to optimize code size and performance. It includes:
      1.pre-shift arithmetic logic operations
      2.immediate compare branch operations
      3.bit manipulation operations
      4.load/store multiple operations
      5.integer/floating-point conditional move operations
      6.half-precision floating-point convert operations
      7.pre-index/post-index integer/floating-point load/store operations
      8.integer/floating-point load/store pair operations
      9.floating point round to integer operations
      10.interrupt nest enable/disable operations
      11.jump operations with large offset
      12.gp-based load/store operations with large offset
      13.multiply-add/sub operations
      14.prefetch operations
      15.stop operation for security

config LOSCFG_ARCH_LINX_M
    bool
    select LOSCFG_ARCH_RISCV_RV32IMC
    select LOSCFG_ARCH_RISCV32
    select LOSCFG_RISCV_LCMP_CLIC if !LOSCFG_INTERRUPT_VENDOR
    help
        This is genenel setup for LinxCore m-profile which should directly
        select this option and add specific processor cores.

# Supported Processor Cores
config LOSCFG_ARCH_LINXCORE_131
    bool
    select LOSCFG_ARCH_RISCV_RV32IMC
    select LOSCFG_ARCH_RISCV32
    select LOSCFG_RISCV_HIMIDEERV200_PLIC if !LOSCFG_INTERRUPT_VENDOR
    help
      linxCore131 do not belong to linxCore m-profile, so do not select LOSCFG_ARCH_LINX_M.

config LOSCFG_ARCH_LINXCORE_170
    bool
    select LOSCFG_ARCH_LINX_M
```
