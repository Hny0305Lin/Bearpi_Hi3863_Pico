## drivers/drivers/hal/efuse/Kconfig
```kconfig
#===============================================================================
# @brief    Kconfig file.
# Copyright (c) HiSilicon (Shanghai) Technologies Co., Ltd. 2023-2023. All rights reserved.
#===============================================================================
config EFUSE_USING_V151
    bool
    prompt "Using EFUSE V151"
    default y
    depends on DRIVER_SUPPORT_EFUSE

config EFUSE_SWITCH_EN
    bool
    prompt "Using EFUSE SWITCH EN"
    default n
    depends on DRIVER_SUPPORT_EFUSE

config EFUSE_REGION_NUM
    int
    prompt "Max REGION of the EFUSE"
    range 1 3
    default 1
    depends on EFUSE_USING_V151
```

## drivers/drivers/hal/gpio/Kconfig
```kconfig
#===============================================================================
# @brief    Kconfig file.
# Copyright (c) HiSilicon (Shanghai) Technologies Co., Ltd. 2022-2022. All rights reserved.
#===============================================================================
config GPIO_USING_V100
    bool
    prompt "Using GPIO V100."
    default y
    depends on DRIVER_SUPPORT_GPIO

config GPIO_USING_V150
    bool
    prompt "Using GPIO V150."
    default y
    depends on DRIVER_SUPPORT_GPIO

config AON_SPECIAL_PIO
    bool
    prompt "GPIO Support aon special pio"
    default y
    depends on GPIO_USING_V100

config GPIO_WITH_ULP
    bool
    prompt "GPIO Support with ulp"
    default y
    depends on GPIO_USING_V100

config GPIO_PWIDTH_A
    int
    prompt "GPIO pin number of group A."
    range 1 32
    default 8
    depends on GPIO_USING_V100

config GPIO_PWIDTH_B
    int
    prompt "GPIO pin number of group B."
    range 1 32
    default 8
    depends on GPIO_USING_V100

config GPIO_PWIDTH_C
    int
    prompt "GPIO pin number of group C."
    range 1 32
    default 8
    depends on GPIO_USING_V100

config GPIO_PWIDTH_D
    int
    prompt "GPIO pin number of group D."
    range 1 32
    default 8
    depends on GPIO_USING_V100

config GPIO_WIDTH
    int
    prompt "GPIO ID code numbers."
    range 1 32
    default 30
    depends on GPIO_USING_V100

config GPIO_BANK_NUM
    int
    prompt "GPIO max group numbers."
    range 1 8
    default 1
    depends on GPIO_USING_V150

config GPIO0_WIDTH
    int
    prompt "GPIO pin number of group 0."
    range 1 32
    default 32
    depends on GPIO_USING_V150

config GPIO1_WIDTH
    int
    prompt "GPIO pin number of group 1."
    range 1 32
    default 32
    depends on GPIO_BANK_NUM > 1 && GPIO_USING_V150

config GPIO2_WIDTH
    int
    prompt "GPIO pin number of group 2."
    range 1 32
    default 32
    depends on GPIO_BANK_NUM > 2 && GPIO_USING_V150

config GPIO3_WIDTH
    int
    prompt "GPIO pin number of group 3."
    range 1 32
    default 32
    depends on GPIO_BANK_NUM > 3 && GPIO_USING_V150

config GPIO4_WIDTH
    int
    prompt "GPIO pin number of group 4."
    range 1 32
    default 32
    depends on GPIO_BANK_NUM > 4 && GPIO_USING_V150

config GPIO5_WIDTH
    int
    prompt "GPIO pin number of group 5."
    range 1 32
    default 32
    depends on GPIO_BANK_NUM > 5 && GPIO_USING_V150

config GPIO6_WIDTH
    int
    prompt "GPIO pin number of group 6."
    range 1 32
    default 32
    depends on GPIO_BANK_NUM > 6 && GPIO_USING_V150

config GPIO7_WIDTH
    int
    prompt "GPIO pin number of group 7."
    range 1 32
    default 32
    depends on GPIO_BANK_NUM > 7 && GPIO_USING_V150
```

## drivers/drivers/hal/i2c/Kconfig
```kconfig
#===============================================================================
# @brief    Kconfig file.
# Copyright (c) HiSilicon (Shanghai) Technologies Co., Ltd. 2023-2023. All rights reserved.
#===============================================================================
config I2C_USING_V100
    bool
    prompt "Using I2C V100."
    default n
    depends on DRIVER_SUPPORT_I2C

config I2C_USING_V150
    bool
    prompt "Using I2C V150."
    default n
    depends on DRIVER_SUPPORT_I2C

config I2C_USING_V151
    bool
    prompt "Using I2C V151."
    default n
    depends on DRIVER_SUPPORT_I2C

config I2C_ADDR_VALID_CHECK
    bool
    prompt "I2C checks the address validity based on the protocol standard."
    default y
    depends on DRIVER_SUPPORT_I2C
```

## drivers/drivers/hal/pinmux/Kconfig
```kconfig
#===============================================================================
# @brief    Kconfig file.
# Copyright (c) HiSilicon (Shanghai) Technologies Co., Ltd. 2022-2022. All rights reserved.
#===============================================================================
choice
    prompt "Select pinctrl type"
    default PINCTRL_USING_CHIPS
    config PINCTRL_USING_V150
        bool "Using pinctrl V150."
    config PINCTRL_USING_CHIPS
        bool "Using chips definition pinctrl."
endchoice

config PINCTRL_SUPPORT_IE
    bool
    prompt "Set pinctrl support input-enable."
    default n
    depends on DRIVER_SUPPORT_PINCTRL

config PINCTRL_SUPPORT_ST
    bool
    prompt "Set pinctrl support schmitt-trigger."
    default n
    depends on DRIVER_SUPPORT_PINCTRL
```

## drivers/drivers/hal/pmp/Kconfig
```kconfig
#===============================================================================
# @brief    Kconfig file.
# Copyright (c) HiSilicon (Shanghai) Technologies Co., Ltd. 2022-2022. All rights reserved.
#===============================================================================
config PMP_USING_RISCV_31
    bool
    prompt "Using the RISC-V31"
    default n
    depends on DRIVER_SUPPORT_PMP

config PMP_USING_RISCV_70
    bool
    prompt "Using the RISC-V70"
    default n
    depends on DRIVER_SUPPORT_PMP
```

## drivers/drivers/hal/pwm/Kconfig
```kconfig
#===============================================================================
# @brief    Kconfig file.
# Copyright (c) HiSilicon (Shanghai) Technologies Co., Ltd. 2022-2022. All rights reserved.
#===============================================================================
config PWM_USING_V151
    bool
    prompt "Using PWM V151"
    default y
    depends on DRIVER_SUPPORT_PWM

config PWM_USING_V150
    bool
    prompt "Using PWM V150"
    default y
    depends on DRIVER_SUPPORT_PWM

config PWM_GROUP_NUM
    int
    prompt "number of groups in PWM"
    range 1 16
    default 6
    depends on DRIVER_SUPPORT_PWM

config PWM_CHANNEL_NUM
    int
    prompt "PWM channel number"
    default 6
    depends on DRIVER_SUPPORT_PWM

config PWM_PRELOAD
    bool
    prompt "Using PWM PRELOAD"
    default n
    depends on PWM_USING_V151
```

## drivers/drivers/hal/rtc_unified/Kconfig
```kconfig
#===============================================================================
# @brief    Kconfig file.
# Copyright (c) HiSilicon (Shanghai) Technologies Co., Ltd. 2022-2022. All rights reserved.
#===============================================================================
config RTC_USING_V100
    bool
    prompt "Using rtc V100."
    default y
    depends on DRIVER_SUPPORT_RTC

config RTC_USING_V150
    bool
    prompt "Using rtc V150."
    default n
    depends on DRIVER_SUPPORT_RTC

config RTC_MAX_NUM
    int
    prompt "RTC max low layer nums."
    default 5
    depends on DRIVER_SUPPORT_RTC

config RTC_0_WIDTH_64
    int
    prompt "Using 64 bits width of rtc0."
    range 0 1
    default 0
    depends on RTC_USING_V150

config RTC_1_WIDTH_64
    int
    prompt "Using 64 bits width of rtc1."
    range 0 1
    default 0
    depends on RTC_USING_V150 && RTC_MAX_NUM > 1

config RTC_2_WIDTH_64
    int
    prompt "Using 64 bits width of rtc2."
    range 0 1
    default 0
    depends on RTC_USING_V150 && RTC_MAX_NUM > 2

config RTC_3_WIDTH_64
    int
    prompt "Using 64 bits width of rtc3."
    range 0 1
    default 0
    depends on RTC_USING_V150 && RTC_MAX_NUM > 3

config RTC_4_WIDTH_64
    int
    prompt "Using 64 bits width of rtc4."
    range 0 1
    default 1
    depends on RTC_USING_V150 && RTC_MAX_NUM > 4

config RTC_5_WIDTH_64
    int
    prompt "Using 64 bits width of rtc5."
    range 0 1
    default 1
    depends on RTC_USING_V150 && RTC_MAX_NUM > 5

config RTC_6_WIDTH_64
    int
    prompt "Using 64 bits width of rtc6."
    range 0 1
    default 1
    depends on RTC_USING_V150 && RTC_MAX_NUM > 6

config RTC_7_WIDTH_64
    int
    prompt "Using 64 bits width of rtc7."
    range 0 1
    default 1
    depends on RTC_USING_V150 && RTC_MAX_NUM > 7

config RTC_STOP_DELAY_SUPPORT
    bool
    prompt "Support hal_rtc delay 32us after stop."
    default n
    depends on RTC_USING_V150

config RTC_STOP_DELAY_USING_OSAL
    bool
    prompt "Using osal to delay."
    default n
    depends on RTC_STOP_DELAY_SUPPORT

config RTC_STOP_DELAY_USING_TCXO
    bool
    prompt "Using TCXO to delay."
    default n
    depends on RTC_STOP_DELAY_SUPPORT

config RTC_STOP_DELAY_USING_SYSTICK
    bool
    prompt "Using systick to delay."
    default n
    depends on RTC_STOP_DELAY_SUPPORT

config RTC_START_DELAY_SUPPORT
    bool
    prompt "Support hal_rtc delay 65us after start."
    default n
    depends on RTC_USING_V150

config RTC_START_DELAY_USING_OSAL
    bool
    prompt "Using osal to delay."
    default n
    depends on RTC_START_DELAY_SUPPORT

config RTC_START_DELAY_USING_TCXO
    bool
    prompt "Using TCXO to delay."
    default n
    depends on RTC_START_DELAY_SUPPORT

config RTC_START_DELAY_USING_SYSTICK
    bool
    prompt "Using systick to delay."
    default n
    depends on RTC_START_DELAY_SUPPORT
```

## drivers/drivers/hal/security_unified/Kconfig
```kconfig
#===============================================================================
# @brief    Kconfig file.
# Copyright (c) HiSilicon (Shanghai) Technologies Co., Ltd. 2023-2023. All rights reserved.
#===============================================================================
config ENTROPY_SOURCES_FROM_FRO
    bool
    prompt "Select the Entropy Sources"
    default n
    depends on DRIVER_SUPPORT_SECURITY_UNIFIED

config TRNG_RING_ENABLE
    bool
    prompt "Enable the Trng Ring"
    default n
    depends on DRIVER_SUPPORT_SECURITY_UNIFIED

config SM_EFUSE_CHECK
    bool
    prompt "Enable the SM Efuse Check"
    default n
    depends on DRIVER_SUPPORT_SECURITY_UNIFIED
```

## drivers/drivers/hal/sio/Kconfig
```kconfig
#===============================================================================
# @brief    Kconfig file.
# Copyright (c) HiSilicon (Shanghai) Technologies Co., Ltd. 2022-2023. All rights reserved.
#===============================================================================
config SIO_USING_V150
    bool
    prompt "SIO Using V150"
    default n

config DATA_LEN_MAX
    int
    prompt "DATA_LEN_MAX"
    default 128
    depends on SIO_USING_V150

config I2S_RX_THRESHOLD
    hex
    prompt "Threshold of the I2S RX channel"
    default 0x0
    depends on SIO_USING_V150

config I2S_TX_THRESHOLD
    hex
    prompt "Threshold of the I2S TX channel"
    default 0x0
    depends on SIO_USING_V150

config I2S_BCLK_DIV_NUM
    hex
    prompt "NUM of the I2S BCLK DIV"
    default 0x4
    depends on SIO_USING_V150

config SIO_USING_V151
    bool
    prompt "SIO Using V151"
    default n
```

## drivers/drivers/hal/spi/Kconfig
```kconfig
#===============================================================================
# @brief    Kconfig file.
# Copyright (c) HiSilicon (Shanghai) Technologies Co., Ltd. 2022-2022. All rights reserved.
#===============================================================================
config SPI_USING_V100
    bool
    prompt "Using SPI V100."
    default y
    depends on DRIVER_SUPPORT_SPI

config SPI_USING_V151
    bool
    prompt "Using SPI V151."
    default y
    depends on DRIVER_SUPPORT_SPI
```

## drivers/drivers/hal/tsensor/Kconfig
```kconfig
#===============================================================================
# @brief    Kconfig file.
# Copyright (c) HiSilicon (Shanghai) Technologies Co., Ltd. 2023-2023. All rights reserved.
#===============================================================================
config TSENSOR_USING_V150
    bool
    prompt "Using Tsensor V150"
    default y
    depends on DRIVER_SUPPORT_TSENSOR

config TSENSOR_USING_V151
    bool
    prompt "Using Tsensor V151"
    default y
    depends on DRIVER_SUPPORT_TSENSOR

config TSENSOR_TEMP_COMPENSATION
    bool
    prompt "Switch of temperature compensation in Tsensor"
    default y
    depends on DRIVER_SUPPORT_TSENSOR

config TSENSOR_DELAY_TIME
    int
    prompt "Reporting delay time of Tsensor"
    range 0 3
    default 1
    depends on DRIVER_SUPPORT_TSENSOR

config TSENSOR_WAIT_TIME_MS
    int
    prompt "Wait time of Tsensor get temperature"
    default 5
    depends on DRIVER_SUPPORT_TSENSOR

config TSENSOR_MULTILEVEL
    bool
    prompt "Switch of Multi-level temperature in Tsensor"
    default y
    depends on DRIVER_SUPPORT_TSENSOR
```

## drivers/drivers/hal/uart/Kconfig
```kconfig
#===============================================================================
# @brief    Kconfig file.
# Copyright (c) HiSilicon (Shanghai) Technologies Co., Ltd. 2022-2022. All rights reserved.
#===============================================================================
config UART_DLF_SIZE
    int
    prompt "UART_DLF_SIZE"
    range 4 6
    default 4
    depends on DRIVER_SUPPORT_UART

config UART_USING_V120
    bool
    prompt "Using UART V120"
    default y
    depends on DRIVER_SUPPORT_UART

config UART_USING_V151
    bool
    prompt "Using UART V151"
    default y
    depends on DRIVER_SUPPORT_UART

config UART_USING_V100
    bool
    prompt "Using UART V100"
    default n
    depends on DRIVER_SUPPORT_UART

config UART_BAUDSET_WAITTIMES_LIMIT
    int
    prompt "the wait loop times when change baudrate for uartv100"
    default 1000
    depends on UART_USING_V100

config UART_IP_VERSION_V151_PRO
    bool
    prompt "the uart ip version from svn version for uartv151 PRO"
    default n
    depends on UART_USING_V151

config UART_RX_EMPTY_TRIG_H
    int
    prompt "the rx empty high trigger for uartv151 PRO"
    range 0 3
    default 2
    depends on UART_IP_VERSION_V151_PRO

config UART_USING_LP_UART
    bool
    prompt "Using LP_UART"
    default n
    depends on DRIVER_SUPPORT_UART
```

## kernel/Kconfig
```kconfig
#===============================================================================
# @brief    Kconfig file.
# Copyright (c) HiSilicon (Shanghai) Technologies Co., Ltd. 2023-2023. All rights reserved.
#===============================================================================
config DRIVER_SUPPORT_LITEOS
    bool
    prompt "Use LiteOS"
    default y
    help
        This option means support LiteOS.

if DRIVER_SUPPORT_LITEOS
    source "kernel/liteos/Kconfig"
endif

menu "osal"
    comment "Config osal."
    osource "kernel/osal/Kconfig"
endmenu
```
