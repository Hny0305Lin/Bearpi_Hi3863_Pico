## kernel/liteos/liteos_v208.5.0/Huawei_LiteOS/build/menuconfig/kconfig.cmake
```kconfig
# Copyright (c) Huawei Technologies Co., Ltd. 2021-2021. All rights reserved.
if(LOSCFG_SAFETY_KERNEL)
    set(KCONFIG_KERNEL_PATH kernel_s)
    set(KCONFIG_ARCH_PATH arch_s)
else()
    set(KCONFIG_KERNEL_PATH kernel)
    set(KCONFIG_ARCH_PATH arch)
endif()

add_custom_target(
    menuconfig
    COMMAND export KCONFIG_KERNEL_PATH=${KCONFIG_KERNEL_PATH} &&
            export KCONFIG_ARCH_PATH=${KCONFIG_ARCH_PATH} &&
            export KCONFIG_OUTPUT_MENUCONFIG_PATH=${LITEOS_CHECK_MENUCONFIG_H} &&
            python3 ${LITEOSTOPDIR}/build/menuconfig/usr_config.py
    WORKING_DIRECTORY ${LITEOSTOPDIR}
)

add_custom_target(
    savemenuconfig
    COMMAND export KCONFIG_KERNEL_PATH=${KCONFIG_KERNEL_PATH} &&
            export KCONFIG_ARCH_PATH=${KCONFIG_ARCH_PATH} &&
            export KCONFIG_OUTPUT_MENUCONFIG_PATH=${LITEOS_CHECK_MENUCONFIG_H} &&
            python3 ${LITEOSTOPDIR}/build/menuconfig/usr_config.py savemenuconfig
    BYPRODUCTS ${LITEOS_CHECK_MENUCONFIG_H}
    WORKING_DIRECTORY ${LITEOSTOPDIR}
)
set_property(TARGET menuconfig PROPERTY STATUS AVAILABLE)
set_property(TARGET savemenuconfig PROPERTY STATUS AVAILABLE)
```

## kernel/liteos/liteos_v208.5.0/Huawei_LiteOS/compat/Kconfig
```kconfig
menu "Compat"
osource "compat/cmsis/Kconfig"
osource "compat/linux/Kconfig"
endmenu
```

## kernel/liteos/liteos_v208.5.0/Huawei_LiteOS/compat/cmsis/Kconfig
```kconfig
config  LOSCFG_COMPAT_CMSIS
    bool "Enable Cmsis"
    default y
    depends on !LOSCFG_KERNEL_SMP
    help
      Answer Y to enable LiteOS support cmsis interface.

if LOSCFG_COMPAT_CMSIS

config LOSCFG_COMPAT_CMSIS_VER_1
    bool "Enable Cmsis Version 1.0"
    default n
    select LOSCFG_KERNEL_MEMBOX
    help
      The Cmsis Version 1.

config LOSCFG_COMPAT_CMSIS_VER_2
    bool "Enable Cmsis Version 2.0"
    default y
    select LOSCFG_KERNEL_MEM_ALLOC
    help
      The Cmsis Version 2.

config LOSCFG_COMPAT_CMSIS_STATIC_ALLOCATION
    bool "CMSIS Support Static Memory"
    depends on !LOSCFG_COMPAT_CMSIS_VER_2
    select LOSCFG_TASK_STACK_STATIC_ALLOCATION
    select LOSCFG_QUEUE_STATIC_ALLOCATION if LOSCFG_BASE_IPC_QUEUE
    default n
    help
      Answer Y to enable LiteOS support cmsis interface.

endif # LOSCFG_COMPAT_CMSIS
```

## kernel/liteos/liteos_v208.5.0/Huawei_LiteOS/compat/linux/Kconfig
```kconfig
config LOSCFG_COMPAT_LINUX
    bool "Enable Linux"
    default y
    select LOSCFG_KERNEL_MEM_ALLOC
    select LOSCFG_BASE_IPC_EVENT
    help
      Answer Y to enable LiteOS support linux interface.

if LOSCFG_COMPAT_LINUX

config LOSCFG_COMPAT_LINUX_PENDLIST
    bool
    default n

config LOSCFG_COMPAT_LINUX_TIMER
    bool "Enable Timer"
    default n
    select LOSCFG_BASE_CORE_SWTMR

config LOSCFG_COMPAT_LINUX_HRTIMER
    bool "Enable Hrtimer"
    default n

config LOSCFG_COMPAT_LINUX_IRQ
    bool "Enable Irq Interrupt"
    default n
    select LOSCFG_HWI_WITH_ARG
    depends on LOSCFG_ARCH_INTERRUPT_TAKEOVER

config LOSCFG_COMPAT_LINUX_SEMAPHORE
    bool "Enable Semaphore"
    default n
    select LOSCFG_BASE_IPC_SEM

config LOSCFG_COMPAT_LINUX_RW_SEMAPHORE
    bool "Enable Rw Semaphore"
    default n
    select LOSCFG_BASE_IPC_RWSEM

config LOSCFG_COMPAT_LINUX_COMPLETION
    bool "Enable Completion"
    default n
    select LOSCFG_COMPAT_LINUX_PENDLIST

config LOSCFG_COMPAT_LINUX_WAITQUEUE
    bool "Enable Waitqueue"
    default n
    select LOSCFG_BASE_IPC_EVENT

config LOSCFG_COMPAT_LINUX_WORKQUEUE
    bool "Enable Workqueue"
    default n
    select LOSCFG_COMPAT_LINUX_TIMER
    select LOSCFG_COMPAT_LINUX_PENDLIST

config LOSCFG_COMPAT_LINUX_DRIVER_BASE
    bool "Enable Driver Base"
    default n
    select LOSCFG_DRIVERS_BASE

config LOSCFG_COMPAT_LINUX_WAKELOCK
    bool "Enable Wakelock"
    default n

config LOSCFG_COMPAT_LINUX_USED
    bool
    default n

config LOSCFG_COMPAT_LINUX_CRC32
    bool "Enable Crc32"
    default n

endif #LOSCFG_COMPAT_LINUX
```

## kernel/liteos/liteos_v208.5.0/Huawei_LiteOS/drivers/Kconfig
```kconfig
menu "Driver"

osource "drivers/base/Kconfig"
osource "drivers/interrupt/Kconfig"
osource "drivers/timer/Kconfig"

config LOSCFG_DRIVERS_UART_LINUX
    bool
    help
      uart is implemented using the Linux driver framework.

config LOSCFG_DRIVERS_UART_LITEOS
    bool
    help
      uart is implemented using the LiteOS driver framework.

osource "drivers/uart/Kconfig"

osource "drivers/gpio/Kconfig"

osource "drivers/i2c/Kconfig"
osource "drivers/mem/Kconfig"
osource "drivers/iommu/Kconfig"

config LOSCFG_DRIVERS_MTD
    bool "Enable MTD"
    default y
    depends on LOSCFG_FS_VFS
    select LOSCFG_COMPAT_LINUX
    select LOSCFG_COMPAT_LINUX_DRIVER_BASE
    help
      Answer Y to enable LiteOS support yaffs and jffs2 multipartion.

osource "drivers/mtd/nand/Kconfig"
osource "drivers/mtd/spi_nor/Kconfig"
osource "drivers/random/Kconfig"
osource "drivers/rtc/Kconfig"
osource "drivers/spi/Kconfig"
osource "drivers/usb/adapt_liteos/Kconfig"
osource "drivers/video/Kconfig"
osource "drivers/cipher/Kconfig"

endmenu
```

## kernel/liteos/liteos_v208.5.0/Huawei_LiteOS/drivers/base/Kconfig
```kconfig
config LOSCFG_DRIVERS_BASE
    bool "Enable Driver Base"
    default n
    help
      Answer Y to enable LiteOS to support driver base
```

## kernel/liteos/liteos_v208.5.0/Huawei_LiteOS/drivers/interrupt/Kconfig
```kconfig
config LOSCFG_INTERRUPT_VENDOR
    bool
    help
      Use vendor interrupt driver.

config LOSCFG_ARM_GIC_V2
    bool
    select LOSCFG_ARCH_INTERRUPT_TAKEOVER
    help
      This GIC(General Interrupt Controller) version 2 driver is compatatble with
      GIC version 1 and version 2.

config LOSCFG_ARM_GIC_V3
    bool
    select LOSCFG_ARCH_INTERRUPT_TAKEOVER
    depends on LOSCFG_ARCH_ARM_V8A || LOSCFG_ARCH_ARM_V8R
    help
      General Interrupt Controller version 3.

config LOSCFG_ARM_GIC_LPI_ENABLE
    bool
    depends on LOSCFG_ARM_GIC_V3
    help
      This option will support LPI.

config LOSCFG_CORTEX_M_NVIC
    bool
    default y
    depends on LOSCFG_ARCH_ARM_CORTEX_M && LOSCFG_ARCH_INTERRUPT_TAKEOVER
    help
      NVIC(Nested Vectored Interrupt Controller) for Cortex-M.

config LOSCFG_XEA3_INT_CONTROLLER
    bool
    select LOSCFG_ARCH_INTERRUPT_TAKEOVER
    help
      General Interrupt Controller xtensa xea3.

config LOSCFG_XEA2_INT_CONTROLLER
    bool
    select LOSCFG_ARCH_INTERRUPT_TAKEOVER
    help
      General Interrupt Controller xtensa xea2.

config LOSCFG_RISCV_HIMIDEERV200_PLIC
    bool
    select LOSCFG_ARCH_INTERRUPT_TAKEOVER
    depends on LOSCFG_ARCH_LINXCORE_131
    help
      Riscv Platform Level Interrupt Controller

config LOSCFG_RISCV_LCMP_CLIC
    bool
    select LOSCFG_ARCH_INTERRUPT_TAKEOVER
    depends on LOSCFG_ARCH_LINX_M
    help
      Riscv Platform Level Interrupt Controller

config LOSCFG_ARM_V5_VIC
    bool
    select LOSCFG_ARCH_INTERRUPT_TAKEOVER
    depends on LOSCFG_ARCH_ARM_V5
    help
      ARM-V5 Platform Level Interrupt Controller

config LOSCFG_LINGLONG_IC
    bool
    select LOSCFG_ARCH_INTERRUPT_TAKEOVER
    depends on LOSCFG_ARCH_LINGLONG
    help
      Linglong Interrupt Controller
```
