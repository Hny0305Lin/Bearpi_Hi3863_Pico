## drivers/drivers/driver/watchdog/Kconfig
```kconfig
#===============================================================================
# @brief    Kconfig file.
# Copyright (c) HiSilicon (Shanghai) Technologies Co., Ltd. 2022-2022. All rights reserved.
#===============================================================================
config WATCHDOG_ALREADY_START
    bool
    prompt "Watchdog has been started in another binary."
    default n
    depends on DRIVER_SUPPORT_WDT

config WATCHDOG_SUPPORT_ULP_WDT
    bool
    prompt "Watch dog support ulp watchdog"
    default n
    depends on DRIVER_SUPPORT_WDT
	
config WATCHDOG_SUPPORT_LPM
    bool
    prompt "Watch dog support low power mode"
    default n
    depends on DRIVER_SUPPORT_WDT
```

## drivers/drivers/hal/adc/Kconfig
```kconfig
#===============================================================================
# @brief    Kconfig file.
# Copyright (c) HiSilicon (Shanghai) Technologies Co., Ltd. 2023-2023. All rights reserved.
#===============================================================================
choice
    prompt "ADC Version"
    default ADC_USING_V152
    config ADC_USING_V151
        bool "ADC use version 151"
    config ADC_USING_V152
        bool "ADC use version 152"
    config ADC_USING_V153
        bool "ADC use version 153"
    config ADC_USING_V154
        bool "ADC use version 154"
endchoice

config ADC_SUPPORT_AFE
    bool
    prompt "ADC use Analog front-end mode"
    default y
    depends on (ADC_USING_V152 || ADC_USING_V153)

config ADC_SUPPORT_DIFFERENTIAL
    bool
    prompt "ADC support differential sample"
    default y
    depends on ADC_USING_V153

config ADC_SUPPORT_AMIC
    bool
    prompt "Whether ADC support AMIC."
    default y
    depends on ADC_USING_V153

config ADC_SUPPORT_HAFE
    bool
    prompt "Whether ADC support HAFE."
    default y
    depends on ADC_USING_V152

config AFE_SAMPLE_TIMES
    int
    prompt "The numbers ADC sample to average."
    default 4
    depends on DRIVER_SUPPORT_ADC
```

## drivers/drivers/hal/dma/Kconfig
```kconfig
#===============================================================================
# @brief    Kconfig file.
# Copyright (c) HiSilicon (Shanghai) Technologies Co., Ltd. 2022-2022. All rights reserved.
#===============================================================================
config DMA_USING_V100
    bool
    prompt "Using DMA V100."
    default y
    depends on DRIVER_SUPPORT_DMA

config DMA_USING_V120
    bool
    prompt "Using DMA V120."
    default y
    depends on DRIVER_SUPPORT_DMA

config DMA_USING_V150
    bool
    prompt "Using DMA V150."
    default n
    depends on DRIVER_SUPPORT_DMA

config DMA_SUPPORT_SMDMA
    bool
    prompt "DMA Support SMDMA"
    default y
    depends on DRIVER_SUPPORT_DMA && DMA_USING_V100

config SUPPORT_DATA_CACHE
    bool
    prompt "DMA SUPPORT DATA CACHE"
    default n
    depends on DRIVER_SUPPORT_DMA
	
config DMA_LLI_NODE_FIX_MEM
    bool
    prompt "dma lli node using static memory"
    default n
    depends on DRIVER_SUPPORT_DMA
	
config DMA_LLI_NODE_MAX
    int
    prompt "dma lli node max count"
    default 4
    depends on DMA_LLI_NODE_FIX_MEM
```
