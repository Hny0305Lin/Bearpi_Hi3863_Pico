## drivers/chips/ws63/rom/drivers/drivers/driver/timer/Kconfig
```kconfig
#===============================================================================
# @brief    Kconfig file.
# Copyright (c) HiSilicon (Shanghai) Technologies Co., Ltd. 2022-2022. All rights reserved.
#===============================================================================
config TIMER_MAX_TIMERS_NUM
    int
    prompt "Max timers num"
    default 16
    depends on DRIVER_SUPPORT_TIMER

config TIMER_CLOCK_VALUE
    int
    prompt "Timer clock value in Hz."
    default 32000000
    depends on DRIVER_SUPPORT_TIMER
```

## drivers/chips/ws63/rom/drivers/drivers/driver/watchdog/Kconfig
```kconfig
#===============================================================================
# @brief    Kconfig file.
# Copyright (c) HiSilicon (Shanghai) Technologies Co., Ltd. 2022-2022. All rights reserved.
#===============================================================================
config WATCHDOG_ALREADY_START
    bool
    prompt "Watchdog has been started in another binary."
    default n
    depends on DRIVER_SUPPORT_WDT
```

## drivers/chips/ws63/rom/drivers/drivers/hal/pinmux/Kconfig
```kconfig
#===============================================================================
# @brief    Kconfig file.
# Copyright (c) HiSilicon (Shanghai) Technologies Co., Ltd. 2022-2022. All rights reserved.
#===============================================================================
choice
    prompt "Select pinctrl type"
    default PINCTRL_USING_V150
    config PINCTRL_USING_V150
        bool "Using pinctrl V150."
    config PINCTRL_USING_LIBRA
        bool "Using LIBRA pinctrl."
    config PINCTRL_USING_BRANDY
        bool "Using BRANDY pinctrl."
    config PINCTRL_USING_BS25
        bool "Using BS25 pinctrl."
endchoice

config PINCTRL_SUPPORT_IE
    bool
    prompt "Set pinctrl support input-enable."
    default n
    depends on DRIVER_SUPPORT_PINCTRL

config PINCTRL_SUPPORT_ST
    bool
    prompt "Set pinctrl support schmitt-trigger."
    default n
    depends on DRIVER_SUPPORT_PINCTRL
```

## drivers/chips/ws63/rom/drivers/drivers/hal/sfc/Kconfig
```kconfig
#===============================================================================
# @brief    Kconfig file.
# Copyright (c) HiSilicon (Shanghai) Technologies Co., Ltd. 2022-2022. All rights reserved.
#===============================================================================
config SFC_DEBUG
    bool
    prompt "SFC Support DEBUG"
    default y
    depends on DRIVER_SUPPORT_SFC
```

## drivers/chips/ws63/rom/drivers/drivers/hal/timer/Kconfig
```kconfig
#===============================================================================
# @brief    Kconfig file.
# Copyright (c) HiSilicon (Shanghai) Technologies Co., Ltd. 2022-2022. All rights reserved.
#===============================================================================
config TIMER_USING_V100
    bool
    prompt "Using timer V100."
    default y
    depends on DRIVER_SUPPORT_TIMER

config TIMER_USING_V150
    bool
    prompt "Using timer V150."
    default y
    depends on DRIVER_SUPPORT_TIMER

config TIMER_MAX_NUM
    int
    prompt "TIMER max low layer nums."
    default 8
    depends on DRIVER_SUPPORT_TIMER

config TIMER_0_WIDTH_64
    int
    prompt "Using 64 bits width of timer0."
    range 0 1
    default 0
    depends on TIMER_USING_V150

config TIMER_1_WIDTH_64
    int
    prompt "Using 64 bits width of timer1."
    range 0 1
    default 0
    depends on TIMER_USING_V150 && TIMER_MAX_NUM > 1

config TIMER_2_WIDTH_64
    int
    prompt "Using 64 bits width of timer2."
    range 0 1
    default 0
    depends on TIMER_USING_V150 && TIMER_MAX_NUM > 2

config TIMER_3_WIDTH_64
    int
    prompt "Using 64 bits width of timer3."
    range 0 1
    default 0
    depends on TIMER_USING_V150 && TIMER_MAX_NUM > 3

config TIMER_4_WIDTH_64
    int
    prompt "Using 64 bits width of timer4."
    range 0 1
    default 1
    depends on TIMER_USING_V150 && TIMER_MAX_NUM > 4

config TIMER_5_WIDTH_64
    int
    prompt "Using 64 bits width of timer5."
    range 0 1
    default 1
    depends on TIMER_USING_V150 && TIMER_MAX_NUM > 5

config TIMER_6_WIDTH_64
    int
    prompt "Using 64 bits width of timer6."
    range 0 1
    default 1
    depends on TIMER_USING_V150 && TIMER_MAX_NUM > 6

config TIMER_7_WIDTH_64
    int
    prompt "Using 64 bits width of timer7."
    range 0 1
    default 1
    depends on TIMER_USING_V150 && TIMER_MAX_NUM > 7
```

## drivers/chips/ws63/rom/drivers/drivers/hal/watchdog/Kconfig
```kconfig
#===============================================================================
# @brief    Kconfig file.
# Copyright (c) HiSilicon (Shanghai) Technologies Co., Ltd. 2022-2022. All rights reserved.
#===============================================================================
config WATCHDOG_USING_V151
    bool
    prompt "Using watchdog V151"
    default y
    depends on DRIVER_SUPPORT_WDT

config WATCHDOG_USING_V100
    bool
    prompt "Using watchdog v100"
    default y
    depends on DRIVER_SUPPORT_WDT

config WATCHDOG_USING_V151_RST_PL
    int
    prompt "Using watchdog_V151 rst_pl"
    range 1 7
    default 7
    depends on WATCHDOG_USING_V151
    help
       <System reset signal effective length configuration register
       3b'000: reset signal effective length is 8'h2
       3b'001: reset signal effective length is 8'h4
       3b'010: reset signal effective length is 8'h8
       3b'011: reset signal effective length is 8'h10
       3b'100: reset signal effective length is 8'h20
       3b'101: reset signal effective length is 8'h40
       3b'110: reset signal effective length is 8'h80
       3b'111: reset signal effective length is 8'h100>
```
