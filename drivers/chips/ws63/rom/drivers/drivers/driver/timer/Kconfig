## drivers/drivers/driver/i2s/Kconfig
```kconfig
#===============================================================================
# @brief    Kconfig file.
# Copyright (c) HiSilicon (Shanghai) Technologies Co., Ltd. 2022-2023. All rights reserved.
#===============================================================================
config I2S_BUS_MAX_NUM
    int
    prompt "I2S_BUS_MAX_NUM"
    default 1
    depends on DRIVER_SUPPORT_I2S

config I2S_SUPPORT_LOOPBACK
    bool
    prompt "I2S_SUPPORT_LOOPBACK"
    default y
    depends on DRIVER_SUPPORT_I2S

config I2S_SUPPORT_DMA
    bool
    prompt "I2S SUPPORT DMA"
    default n
    depends on DRIVER_SUPPORT_I2S

config I2S_SCLK_PIN
    int
    prompt "Choose I2S SCLK pin."
    depends on DRIVER_SUPPORT_I2S
    default 13

config I2S_WS_PIN
    int
    prompt "Choose I2S WS pin."
    depends on DRIVER_SUPPORT_I2S
    default 14

config I2S_DO_PIN
    int
    prompt "Choose I2S DO pin."
    depends on DRIVER_SUPPORT_I2S
    default 15

config I2S_DI_PIN
    int
    prompt "Choose I2S DI pin."
    depends on DRIVER_SUPPORT_I2S
    default 16

config I2S_SCLK_PIN_MODE
    int
    prompt "Choose I2S SCLK pin mode."
    depends on DRIVER_SUPPORT_I2S
    default 35

config I2S_WS_PIN_MODE
    int
    prompt "Choose I2S WS pin mode."
    depends on DRIVER_SUPPORT_I2S
    default 36

config I2S_DO_PIN_MODE
    int
    prompt "Choose I2S DO pin mode."
    depends on DRIVER_SUPPORT_I2S
    default 37

config I2S_DI_PIN_MODE
    int
    prompt "Choose I2S DI pin mode."
    depends on DRIVER_SUPPORT_I2S
    default 38

config I2S_SUPPORT_QUERY_REGS
    bool
    prompt "I2S support query regs values"
    default n
    depends on DRIVER_SUPPORT_I2S
```

## drivers/drivers/driver/pinmux/Kconfig
```kconfig
#===============================================================================
# @brief    Kconfig file.
# Copyright (c) HiSilicon (Shanghai) Technologies Co., Ltd. 2023-2023. All rights reserved.
#===============================================================================
config PINCTRL_SUPPORT_LPM
    bool
    prompt "PINCTRL Support low power mode, supend and reusme"
    default n
    depends on DRIVER_SUPPORT_PINCTRL
```

## drivers/drivers/driver/rtc_unified/Kconfig
```kconfig
#===============================================================================
# @brief    Kconfig file.
# Copyright (c) HiSilicon (Shanghai) Technologies Co., Ltd. 2022-2022. All rights reserved.
#===============================================================================
config RTC_MAX_RTCS_NUM
    int
    prompt "Max number of the RTC."
    default 16
    depends on DRIVER_SUPPORT_RTC

config RTC_CLOCK_VALUE
    int
    prompt "RTC clock value in Hz."
    default 32768
    depends on DRIVER_SUPPORT_RTC

config RTC_USING_OLD_VERSION
    bool
    prompt "RTC ip using old version, load count must be aligned with 0xF."
    default n
    depends on DRIVER_SUPPORT_RTC

config RTC_SUPPORT_LPM
    bool
    prompt "RTC Support low power resume"
    default n
    depends on DRIVER_SUPPORT_RTC
```

## drivers/drivers/driver/security/hash/Kconfig
```kconfig
#===============================================================================
# @brief    Kconfig file.
# Copyright (c) HiSilicon (Shanghai) Technologies Co., Ltd. 2022-2022. All rights reserved.
#===============================================================================
config HASH_SUPPORT_SHA512
    bool
    prompt "Hash support SHA512"
    default n
    depends on DRIVER_SUPPORT_HASH
```

## drivers/drivers/driver/security_unified/Kconfig
```kconfig
#===============================================================================
# @brief    Kconfig file.
# Copyright (c) HiSilicon (Shanghai) Technologies Co., Ltd. 2023-2023. All rights reserved.
#===============================================================================

# module config
config SECURITY_UNIFIED_SUPPORT_DEEP_SLEEP
    bool
    prompt "Support deepsleep feature"
    default n
    depends on DRIVER_SUPPORT_SECURITY_UNIFIED

config SECURITY_UNIFIED_SUPPORT_SYMC
    bool
    prompt "security_unified support symc"
    default n
    depends on DRIVER_SUPPORT_SECURITY_UNIFIED

config SECURITY_UNIFIED_SUPPORT_HASH
    bool
    prompt "security_unified support hash"
    default n
    depends on DRIVER_SUPPORT_SECURITY_UNIFIED

config SPACC_IRQ_ENABLE
    bool
    prompt "security_unified support spacc irq"
    default n
    depends on SECURITY_UNIFIED_SUPPORT_HASH || SECURITY_UNIFIED_SUPPORT_SYMC

config SECURITY_UNIFIED_SUPPORT_TRNG
    bool
    prompt "security_unified support trng"
    default n
    depends on DRIVER_SUPPORT_SECURITY_UNIFIED

config SECURITY_UNIFIED_SUPPORT_KM
    bool
    prompt "security_unified support km"
    default n
    depends on DRIVER_SUPPORT_SECURITY_UNIFIED

config SECURITY_UNIFIED_SUPPORT_FAPC
    bool
    prompt "security_unified support fapc"
    default n
    depends on DRIVER_SUPPORT_SECURITY_UNIFIED

config SECURITY_UNIFIED_SUPPORT_PKE
    bool
    prompt "security_unified support pke"
    default n
    depends on DRIVER_SUPPORT_SECURITY_UNIFIED

config PKE_IRQ_ENABLE
    bool
    prompt "security_unified support pke irq"
    default n
    depends on SECURITY_UNIFIED_SUPPORT_PKE

# support curve config
config PKE_SUPPORT_ECC_FIPS_P192R
    bool
    prompt "security_unified support ecc fips192r"
    default y
    depends on SECURITY_UNIFIED_SUPPORT_PKE

config PKE_SUPPORT_ECC_FIPS_P224R
    bool
    prompt "security_unified support ecc fips224r"
    default y
    depends on SECURITY_UNIFIED_SUPPORT_PKE

config PKE_SUPPORT_ECC_FIPS_P256R
    bool
    prompt "security_unified support ecc fips256r"
    default y
    depends on SECURITY_UNIFIED_SUPPORT_PKE

config PKE_SUPPORT_ECC_FIPS_P384R
    bool
    prompt "security_unified support ecc fips384r"
    default y
    depends on SECURITY_UNIFIED_SUPPORT_PKE

config PKE_SUPPORT_ECC_FIPS_P521R
    bool
    prompt "security_unified support ecc fips521r"
    default y
    depends on SECURITY_UNIFIED_SUPPORT_PKE

config PKE_SUPPORT_ECC_BP256R
    bool
    prompt "security_unified support ecc brainpool p256r"
    default y
    depends on SECURITY_UNIFIED_SUPPORT_PKE

config PKE_SUPPORT_ECC_BP384R
    bool
    prompt "security_unified support ecc brainpool p384r"
    default y
    depends on SECURITY_UNIFIED_SUPPORT_PKE

config PKE_SUPPORT_ECC_BP512R
    bool
    prompt "security_unified support ecc brainpool p512r"
    default y
    depends on SECURITY_UNIFIED_SUPPORT_PKE

config PKE_SUPPORT_CURVE
    bool
    prompt "security_unified support RFC7748"
    default y
    depends on SECURITY_UNIFIED_SUPPORT_PKE

config PKE_SUPPORT_ECC_CURVE_25519
    bool
    prompt "security_unified support curve 25519"
    default y
    depends on PKE_SUPPORT_CURVE

config PKE_SUPPORT_ECC_CURVE_448
    bool
    prompt "security_unified support curve 448"
    default y
    depends on PKE_SUPPORT_CURVE

config PKE_SUPPORT_EDWARD
    bool
    prompt "security_unified support RFC8032"
    default y
    depends on SECURITY_UNIFIED_SUPPORT_PKE

config PKE_SUPPORT_ECC_ED25519
    bool
    prompt "security_unified support Edward 25519"
    default y
    depends on PKE_SUPPORT_EDWARD

config PKE_SUPPORT_ECC_ED448
    bool
    prompt "security_unified support Edward 448"
    default n
    depends on PKE_SUPPORT_EDWARD

config PKE_SUPPORT_SM2
    bool
    prompt "security_unified support sm2"
    default y
    depends on SECURITY_UNIFIED_SUPPORT_PKE

config PKE_SUPPORT_SM2_SIGN
    bool
    prompt "security_unified support sm2 sign"
    default y
    depends on PKE_SUPPORT_SM2

config PKE_SUPPORT_SM2_VERIFY
    bool
    prompt "security_unified support sm2 verify"
    default y
    depends on PKE_SUPPORT_SM2

config PKE_SUPPORT_SM2_CRYPTO
    bool
    prompt "security_unified support sm2 crypto"
    default y
    depends on PKE_SUPPORT_SM2

config PKE_SUPPORT_RSA
    bool
    prompt "security_unified support RSA"
    default y
    depends on SECURITY_UNIFIED_SUPPORT_PKE

# feature config, eg. sign, verify, crypto, ecdh, gen_key
config PKE_SUPPORT_ECC_SIGN
    bool
    prompt "security_unified support ecc sign"
    default y
    depends on SECURITY_UNIFIED_SUPPORT_PKE

config PKE_SUPPORT_ECC_VERIFY
    bool
    prompt "security_unified support ecc verify"
    default y
    depends on SECURITY_UNIFIED_SUPPORT_PKE

config PKE_SUPPORT_ECC_ECDH
    bool
    prompt "security_unified support ecc ecdh"
    default y
    depends on SECURITY_UNIFIED_SUPPORT_PKE

config PKE_SUPPORT_ECC_GEN_KEY
    bool
    prompt "security_unified support ecc generate key"
    default y
    depends on SECURITY_UNIFIED_SUPPORT_PKE

config PKE_SUPPORT_ECC_CAL
    bool
    prompt "security_unified support ecc big number calculation"
    default y
    depends on SECURITY_UNIFIED_SUPPORT_PKE

config PKE_SUPPORT_BIG_NUMBER
    bool
    prompt "security_unified support big number calculation"
    default y
    depends on SECURITY_UNIFIED_SUPPORT_PKE
```

## drivers/drivers/driver/spi/Kconfig
```kconfig
#===============================================================================
# @brief    Kconfig file.
# Copyright (c) HiSilicon (Shanghai) Technologies Co., Ltd. 2022-2022. All rights reserved.
#===============================================================================

config SPI_SUPPORT_MASTER
    bool
    prompt "SPI Support MASTER"
    default y
    depends on DRIVER_SUPPORT_SPI

config SPI_SUPPORT_SLAVE
    bool
    prompt "SPI Support SLAVE"
    default y
    depends on DRIVER_SUPPORT_SPI

config SPI_SUPPORT_DMA
    bool
    prompt "SPI Support DMA transfer"
    default n
    depends on DRIVER_SUPPORT_SPI
    select DRIVER_SUPPORT_DMA

config SPI_SUPPORT_POLL_AND_DMA_AUTO_SWITCH
    bool
    prompt "SPI Support poll and dma mode switch"
    default n
    depends on SPI_SUPPORT_DMA

config SPI_AUTO_SWITCH_DMA_THRESHOLD
    int
    prompt "SPI indicates the threshold of the automatic switchover mode"
    range 0 65535
    default 32
    depends on SPI_SUPPORT_POLL_AND_DMA_AUTO_SWITCH

config SPI_SUPPORT_INTERRUPT
    bool
    prompt "SPI Support interrupt transfer"
    default n
    depends on DRIVER_SUPPORT_SPI && !SPI_SUPPORT_POLL_AND_DMA_AUTO_SWITCH

config SPI_SUPPORT_CONCURRENCY
    bool
    prompt "SPI support concurrency and the mode can be switched only after the transmission is complete"
    default n
    depends on DRIVER_SUPPORT_SPI

config SPI_SUPPORT_LOOPBACK
    bool
    prompt "SPI Support LOOPBACK"
    default n
    depends on DRIVER_SUPPORT_SPI

config SPI_SUPPORT_CRC
    bool
    prompt "SPI Support CRC"
    default n
    depends on DRIVER_SUPPORT_SPI

config SPI_MAX_TIMEOUT
    hex
    prompt "Max time of SPI waiting"
    default 0xFFFFFFFF
    depends on DRIVER_SUPPORT_SPI

config SPI_TXFTLR
    hex
    prompt "Transmit FIFO threshold level"
    default 1
    depends on DRIVER_SUPPORT_SPI

config SPI_RXFTLR
    hex
    prompt "Receive FIFO threshold level"
    default 1
    depends on DRIVER_SUPPORT_SPI

config SPI_SUPPORT_LPC
    bool
    prompt "SPI Support low power control, control power and clock"
    default n
    depends on DRIVER_SUPPORT_SPI

config SPI_SUPPORT_LPM
    bool
    prompt "SPI Support low power mode, supend and reusme"
    default n
    depends on DRIVER_SUPPORT_SPI

config SPI_SUPPORT_SINGLE_SPI
    bool
    prompt "SPI Support single mode"
    default n
    depends on DRIVER_SUPPORT_SPI

config SPI_NOT_SUPPORT_TEXAS_FORMAT
    bool
    prompt "SPI Support Texas Instruments SSP Frame Format or not."
    default y
    depends on DRIVER_SUPPORT_SPI

config SPI_SUPPORT_QUERY_REGS
    bool
    prompt "SPI support query regs values"
    default n
    depends on DRIVER_SUPPORT_SPI
```

## drivers/drivers/driver/systick/Kconfig
```kconfig
#===============================================================================
# @brief    Kconfig file.
# Copyright (c) HiSilicon (Shanghai) Technologies Co., Ltd. 2023-2023. All rights reserved.
#===============================================================================
config SYSTICK_SUPPORT_LPM
    bool
    prompt "Systick Support low power mode, supend and reusme"
    default n
    depends on DRIVER_SUPPORT_SYSTICK
```

## drivers/drivers/driver/tcxo/Kconfig
```kconfig
#===============================================================================
# @brief    Kconfig file.
# Copyright (c) HiSilicon (Shanghai) Technologies Co., Ltd. 2023-2023. All rights reserved.
#===============================================================================
config TCXO_SUPPORT_LPM
    bool
    prompt "TCXO Support low power mode, supend and reusme"
    default n
    depends on DRIVER_SUPPORT_TCXO
```

## drivers/drivers/driver/timer/Kconfig
```kconfig
#===============================================================================
# @brief    Kconfig file.
# Copyright (c) HiSilicon (Shanghai) Technologies Co., Ltd. 2022-2022. All rights reserved.
#===============================================================================
config TIMER_MAX_TIMERS_NUM
    int
    prompt "Max timers num"
    default 16
    depends on DRIVER_SUPPORT_TIMER

config TIMER_CLOCK_VALUE
    int
    prompt "Timer clock value in Hz."
    default 32000000
    depends on DRIVER_SUPPORT_TIMER

config TIMER_SUPPORT_LPC
    bool
    prompt "Timer Support low power control, control power and clock"
    default n
    depends on DRIVER_SUPPORT_TIMER

config TIMER_USING_OLD_VERSION
    bool
    prompt "TIMER ip using old version, load count must be aligned with 0xF."
    default n
    depends on DRIVER_SUPPORT_TIMER

config TIMER_SUPPORT_LPM
    bool
    prompt "Timer Support low power resume"
    default n
    depends on DRIVER_SUPPORT_TIMER
```

## drivers/drivers/driver/uart/Kconfig
```kconfig
#===============================================================================
# @brief    Kconfig file.
# Copyright (c) HiSilicon (Shanghai) Technologies Co., Ltd. 2022-2022. All rights reserved.
#===============================================================================
config UART_BAUD_RATE_DIV_8
    bool
    prompt "UART Baud rate div 8"
    default y
    depends on DRIVER_SUPPORT_UART

config UART_SUPPORT_TX
    bool
    prompt "UART Support TX"
    default y
    depends on DRIVER_SUPPORT_UART

config UART_SUPPORT_TX_INT
    bool
    prompt "UART Support TX interriupt mode"
    default y
    depends on DRIVER_SUPPORT_UART

config UART_SUPPORT_RX
    bool
    prompt "UART Support RX"
    default y
    depends on DRIVER_SUPPORT_UART

config UART_SUPPORT_DMA
    bool
    prompt "UART Support dma"
    default y
    depends on DRIVER_SUPPORT_UART
    select DRIVER_SUPPORT_DMA

config UART_SUPPORT_FLOW_CTRL
    bool
    prompt "UART Support flow control"
    default n
    depends on DRIVER_SUPPORT_UART

config UART_SUPPORT_HW_FLOW_CTRL
    bool
    prompt "UART Support hardware flow control"
    default n
    depends on UART_SUPPORT_FLOW_CTRL

config UART_SUPPORT_SW_FLOW_CTRL
    bool
    prompt "UART Support software flow control"
    default n
    depends on UART_SUPPORT_FLOW_CTRL

config UART_SUPPORT_LPM
    bool
    prompt "UART Support low power mode, supend and reusme"
    default y
    depends on DRIVER_SUPPORT_UART

config UART_FIFO_DEPTH
    int
    prompt "UART_FIFO_DEPTH"
    range 64 128
    default 64
    depends on DRIVER_SUPPORT_UART

config UART_SUPPORT_LPC
    bool
    prompt "UART Support low power control, control power and clock"
    default n
    depends on DRIVER_SUPPORT_UART

config UART_NOT_SUPPORT_RX_CONDITON_SIZE_OPTIMIZE
    bool
    prompt "UART don't support rx condition size optimization"
    default n
    depends on UART_SUPPORT_RX

config UART_SUPPORT_QUERY_REGS
    bool
    prompt "UART support query regs values"
    default n
    depends on DRIVER_SUPPORT_UART
```
