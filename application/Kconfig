## application/samples/products/sle_uart/Kconfig
```kconfig
#===============================================================================
# @brief    Kconfig file.
# Copyright (c) @CompanyNameMagicTag 2023-2023. All rights reserved.
#===============================================================================

config SLE_UART_BUS
    int
    prompt "Set the UART BUS of the currrent sample."
    default 0
    depends on SAMPLE_SUPPORT_SLE_UART
    help
        This option means the UART BUS of the currrent sample.

config UART_TXD_PIN
    int
    prompt "Choose UART TXD pin."
    depends on SAMPLE_SUPPORT_SLE_UART
    default 17

config UART_RXD_PIN
    int
    prompt "Choose UART RXD pin."
    depends on SAMPLE_SUPPORT_SLE_UART
    default 18

choice
    prompt "Select sle uart type"
    default SAMPLE_SUPPORT_SLE_UART_SERVER
    config SAMPLE_SUPPORT_SLE_UART_SERVER
        bool "Enable SLE UART Server sample."
    config SAMPLE_SUPPORT_SLE_UART_CLIENT
        bool "Enable SLE UART Client sample."
endchoice

menu "Select SLE UART sample mode"
choice
    prompt "Select sle uart sample type"
    default SAMPLE_SUPPORT_NORMAL_TYPE
    config SAMPLE_SUPPORT_NORMAL_TYPE
        bool "Enable SLE UART normal sample."
    config SAMPLE_SUPPORT_LOW_LATENCY_TYPE
        bool "Enable SLE UART low latency sample."
endchoice

config SAMPLE_SUPPORT_PERFORMANCE_TYPE
    bool
    prompt "Set the currrent sample in PERFORMANCE mode."
    default n
    depends on SAMPLE_SUPPORT_LOW_LATENCY_TYPE
    help
        This option means the currrent sample is in performance mode.
endmenu


config SUPPORT_SLE_PERIPHERAL
    bool
    default y if (SAMPLE_SUPPORT_SLE_UART_SERVER)


config SUPPORT_SLE_CENTRAL
    bool
    default y if (SAMPLE_SUPPORT_SLE_UART_CLIENT)
```

## application/samples/wifi/Kconfig
```kconfig
#===============================================================================
# @brief    Kconfig file.
# Copyright (c) @CompanyNameMagicTag 2023-2023. All rights reserved.
#===============================================================================
config SAMPLE_SUPPORT_STA_SAMPLE
    bool "Support WIFI STA Sample"

config SAMPLE_SUPPORT_SOFTAP_SAMPLE
    bool "Support WIFI SoftAP Sample."
    
config SAMPLE_SUPPORT_UDP_CLIENT_SAMPLE
    bool "Support UDP Client Sample."
    
```

## bootloader/Kconfig
```kconfig
#===============================================================================
# @brief    Kconfig file.
# Copyright (c) HiSilicon (Shanghai) Technologies Co., Ltd. 2022-2023. All rights reserved.
#===============================================================================
config BOOT_SUPPORT_SEC
    bool
    prompt "BOOT SEC"
    default n
    help
        This option means boot support sec.

if BOOT_SUPPORT_SEC
menu "Boot Sec Configuration"
    comment "Boot hash"
    osource "bootloader/commonboot/Kconfig"
endmenu
endif

config BOOT_SUPPORT_SECURE_VERIFY
    bool
    prompt "BOOT VERIFY"
    default n
    help
        This option means boot support secure verify.

if BOOT_SUPPORT_SECURE_VERIFY
menu "Boot Secure Verify Configuration"
    comment "Boot secure verify"
    osource "bootloader/commonboot/Kconfig"
endmenu
endif

config BOOT_SUPPORT_PARTITION
    bool
    prompt "BOOT PARTITION"
    default n
    help
        This option means boot support partition.

config LOADERBOOT_SUPPORT_EFUSE_BURN
    bool
    prompt "LOADERBOOT EFUSE BURN"
    default n
    help
        This option means loaderboot support efuse burn.

config LOADERBOOT_SUPPORT_FLASH_CHIP_ERASE
    bool
    prompt "LOADERBOOT FLASH CHIP ERASE"
    default n
    help
        This option means loaderboot support flash chip erase.

if LOADERBOOT_SUPPORT_EFUSE_BURN
menu "Loaderboot Hash Configuration"
    comment "Boot hash"
    osource "bootloader/commonboot/Kconfig"
endmenu
endif

config LOADERBOOT_SUPPORT_UPLOAD_DATA
    bool
    prompt "LOADERBOOT UPLOAD DATA"
    default n
    help
        This option means loaderboot support data upload.

config LOADERBOOT_SUPPORT_READ_VERSION
    bool
    prompt "LOADERBOOT READ VERSION"
    default n
    help
        This option means loaderboot support version read.


config LOADERBOOT_SUPPORT_SET_BUADRATE
    bool
    prompt "LOADERBOOT SET BUADRATE"
    default n
    help
        This option means loaderboot support set baudrate.
```

## bootloader/commonboot/Kconfig
```kconfig
#===============================================================================
# @brief    Kconfig file.
# Copyright (c) HiSilicon (Shanghai) Technologies Co., Ltd. 2022-2023. All rights reserved.
#===============================================================================

config BOOT_SUPPORT_HASH
    bool
    prompt "Hash"
    default n
    depends on BOOT_SUPPORT_SEC
    help
        This option means boot support hash check.

config BOOT_SUPPORT_ECC_VERIFY
    bool
    prompt "Ecc Verify"
    default n
    depends on BOOT_SUPPORT_SECURE_VERIFY
    help
        This option means boot support ecc verify.

config BOOT_SUPPORT_SM2_VERIFY
    bool
    prompt "Sm2 Verify"
    default n
    depends on BOOT_SUPPORT_SECURE_VERIFY
    help
        This option means boot support sm2 verify.

config BOOT_SUPPORT_RSA3072_VERIFY
    bool
    prompt "Rsa3072 Verify"
    default n
    depends on BOOT_SUPPORT_SECURE_VERIFY
    help
        This option means boot support rsa3072 verify.

config BOOT_SUPPORT_RSA4096_VERIFY
    bool
    prompt "Rsa4096 Verify"
    default n
    depends on BOOT_SUPPORT_SECURE_VERIFY
    help
        This option means boot support rsa4096 verify.

config BOOT_SUPPORT_SOFT_VERIFY
    bool
    prompt "Soft Verify"
    default n
    depends on BOOT_SUPPORT_SECURE_VERIFY
    help
        This option means boot support soft verify.

config FLASH_BOOT_SUPPORT_ROM_API
    bool
    prompt "flashboot support rom API"
    default n
    depends on BOOT_SUPPORT_SECURE_VERIFY
    help
        This option means flashboot support rom API.

if CHIP_WS63 || CHIP_WS53
    config ROM_EXPEND_SUPPORT_NOT_ALIGNED
        bool
        prompt "expand rom sha256 API to support data_length not 64 bytes aligned. only need by ws63 & ws53."
        default n
        depends on FLASH_BOOT_SUPPORT_ROM_API
        help
            This option means the sha256 data_length support not 64 bytes aligned.
endif

config LOADERBOOT_SUPPORT_SW_HASH
    bool
    prompt "Loaderboot Support Software Hash"
    default n
    depends on LOADERBOOT_SUPPORT_EFUSE_BURN
    help
        This option means flashboot support software hash.

config LOADERBOOT_SUPPORT_DYNAMIC_PACKET_SIZE
    bool
    prompt "Loaderboot Support Dynamic Download Packet Size."
    default n
    help
        This option means loaderboot support dynamic packet size.

config YMODEM_PACKET_BUFFER_SZIE
    int
    prompt "ymodem buffer size in loaderboot."
    depends on LOADERBOOT_SUPPORT_DYNAMIC_PACKET_SIZE
    default 1024
    help
        This option means the max buffer size to store ymodem packet.

config FLASH_WRITE_SIZE
    int
    prompt "flash write size for one time in loaderboot."
    depends on LOADERBOOT_SUPPORT_DYNAMIC_PACKET_SIZE
    default 1024
    help
        This option means write flash size for one time.
```

## config.in
```kconfig
#===============================================================================
# @brief    Kconfig file.
# Copyright (c) HiSilicon (Shanghai) Technologies Co., Ltd. 2022-2022. All rights reserved.
#===============================================================================
mainmenu "Configuration"
comment "Main menu description, show how to use this configuration system."

menu "Targets"
    comment "Select the target."
endmenu

menu "Application"
    comment "Config the application."
    osource "application/Kconfig"
endmenu

menu "Bootloader"
    comment "Config the bootloader."
    osource "bootloader/Kconfig"
endmenu

menu "Drivers"
    comment "Config the drivers."
    osource "drivers/Kconfig"
endmenu

menu "Kernel"
    comment "Config the kernel."
    osource "kernel/Kconfig"
endmenu

menu "Middleware"
    comment "Config the middleware."
    osource "middleware/Kconfig"
endmenu

menu "Protocol"
    comment "Config the protocol."
    osource "protocol/Kconfig"
endmenu

menu "Test"
    comment "Config the test."
    osource "test/Kconfig"
endmenu
```

## drivers/Kconfig
```kconfig
#===============================================================================
# @brief    Kconfig file.
# Copyright (c) HiSilicon (Shanghai) Technologies Co., Ltd. 2022-2022. All rights reserved.
#===============================================================================
menu "Boards"
    comment "Config the drivers of boards."
    osource "drivers/boards/Kconfig"
endmenu

menu "Chips"
    comment "Config the drivers of chips."
    osource "drivers/chips/Kconfig"
endmenu

menu "Drivers"
    comment "Config the drivers."
    osource "drivers/drivers/Kconfig"
endmenu
```

## drivers/boards/Kconfig
```kconfig
#===============================================================================
# @brief    Kconfig file.
# Copyright (c) HiSilicon (Shanghai) Technologies Co., Ltd. 2022-2022. All rights reserved.
#===============================================================================

if CHIP_WS53
menu "Boards Configurations for ws53"
    comment "Config ws53"
    osource "drivers/boards/ws53/Kconfig"
endmenu
endif

if CHIP_WS63
menu "Boards Configurations for ws63"
    comment "Config ws63"
    osource "drivers/boards/ws63/Kconfig"
endmenu
endif
```

## drivers/boards/ws63/Kconfig
```kconfig
#===============================================================================
# @brief    Kconfig file.
# Copyright (c) HiSilicon (Shanghai) Technologies Co., Ltd. 2023-2023. All rights reserved.
#===============================================================================

config MEMORY_CUSTOMIZE_SEC
    bool "Customize sections"
    default n
    --help--
        Turn on this option, a output section will be added

config MEMORY_CUSTOMIZE_RSV
    bool "Customize memory reserve"
    default n
    --help--
        Memory recovery will be turned on
```

## drivers/chips/Kconfig
```kconfig
#===============================================================================
# @brief    Kconfig file.
# Copyright (c) HiSilicon (Shanghai) Technologies Co., Ltd. 2022-2022. All rights reserved.
#===============================================================================

choice
    prompt "Choose Chip"
    optional

config CHIP_WS53
    bool "ws53"

config CHIP_WS63
    bool "ws63"

endchoice

if CHIP_WS53
menu "Chip Configurations for ws53"
    comment "Config ws53"
    osource "drivers/chips/ws53/Kconfig"
endmenu
endif

if CHIP_WS63
menu "Chip Configurations for ws63"
    comment "Config ws63"
    osource "drivers/chips/ws63/Kconfig"
endmenu
endif
```

## drivers/chips/ws63/Kconfig
```kconfig
#===============================================================================
# @brief    Kconfig file.
# Copyright (c) HiSilicon (Shanghai) Technologies Co., Ltd. 2023-2023. All rights reserved.
#===============================================================================

choice
    prompt "CONFIG_BGLE_RAM_SIZE_16/32/64K, choose one of them"

config BGLE_RAM_SIZE_16K
    bool "16K"

config BGLE_RAM_SIZE_32K
    bool "32K"

config BGLE_RAM_SIZE_64K
    bool "64K"

endchoice


# 这里应该 depends on WiFi的radar特性宏
choice
    prompt "CONFIG_RADAR_SENSOR_RX_MEM_SIZE_8/16/24/32K, choose one of them"

config RADAR_SENSOR_RX_MEM_8K
    bool "8K"

config RADAR_SENSOR_RX_MEM_16K
    bool "16K"

config RADAR_SENSOR_RX_MEM_24K
    bool "24K"

config RADAR_SENSOR_RX_MEM_32K
    bool "32K"

endchoice

config LWIP_COMPILE_PATH
    string
    prompt"CONFIGURE LWIP COMPILE PATH"
    --help--
        configure lwip compile path

config PRINTF_BUFFER_DYNAMIC
    bool
    prompt "support long size print over 128 Bytes"
    default y

config UART0_BAUDRATE
    int
    prompt "cfg uart0's baudrate"
    range 9600 10000000
    default 115200

config UART1_BAUDRATE
    int
    prompt "cfg uart1's baudrate"
    range 9600 10000000
    default 115200

config UART2_BAUDRATE
    int
    prompt "cfg uart2's baudrate"
    range 9600 10000000
    default 115200

config DEBUG_UART
    int
    prompt "debug uart, select 3 means don't use this func"
    range 0 3
    default 0

config DEBUG_UART_BAUDRATE
    int
    prompt "debug uart's baudrate, default selected based on UARTx_BAUDRATE"
    default UART0_BAUDRATE if DEBUG_UART = 0
    default UART1_BAUDRATE if DEBUG_UART = 1
    default UART2_BAUDRATE if DEBUG_UART = 2
    depends on DEBUG_UART < 3

config LOG_UART
    int
    prompt "log uart, select 3 means don't use this func"
    range 0 3
    default 1

config LOG_UART_BAUDRATE
    int
    prompt "log uart's baudrate, default selected based on UARTx_BAUDRATE"
    default UART0_BAUDRATE if LOG_UART = 0
    default UART1_BAUDRATE if LOG_UART = 1
    default UART2_BAUDRATE if LOG_UART = 2
    depends on LOG_UART < 3

config AT_UART
    int
    prompt "at uart, select 3 means don't use this func"
    range 0 3
    default 0

config AT_UART_BAUDRATE
    int
    prompt "at uart's baudrate, default selected based on UARTx_BAUDRATE"
    default UART0_BAUDRATE if AT_UART = 0
    default UART1_BAUDRATE if AT_UART = 1
    default UART2_BAUDRATE if AT_UART = 2
    depends on AT_UART < 3

config WVT_UART
    int
    prompt "wvt uart, select 3 means don't use this func"
    range 0 3
    default 2

config WVT_UART_BAUDRATE
    int
    prompt "wvt uart's baudrate, default selected based on UARTx_BAUDRATE"
    default UART0_BAUDRATE if WVT_UART = 0
    default UART1_BAUDRATE if WVT_UART = 1
    default UART2_BAUDRATE if WVT_UART = 2
    depends on WVT_UART < 3

config TESTSUIT_UART
    int
    prompt "testsuit uart, select 3 means don't use this func"
    range 0 3
    default 0

config TESTSUIT_UART_BAUDRATE
    int
    prompt "wvt uart's baudrate, default selected based on UARTx_BAUDRATE"
    default UART0_BAUDRATE if TESTSUIT_UART = 0
    default UART1_BAUDRATE if TESTSUIT_UART = 1
    default UART2_BAUDRATE if TESTSUIT_UART = 2
    default 0 if TESTSUIT_UART = 3
    depends on TESTSUIT_UART < 3

config REG_WHITELIST
    bool
    prompt "access to registers in the whitelist"
    default y

config UART0_SUPPORT_WRITE_MUTEX
    int
    prompt "uart0 support write mutex"
    range 0 1
    default 1

config UART1_SUPPORT_WRITE_MUTEX
    int
    prompt "uart1 support write mutex"
    range 0 1
    default 1

config UART2_SUPPORT_WRITE_MUTEX
    int
    prompt "uart2 support write mutex"
    range 0 1
    default 1

config UART_SUPPORT_PORTTING_IRQ
    bool
    prompt "support uart portting irq"
    default n

config PM_SUPPORT_WKUP_UART
    int
    prompt "PM config wakeup uart"
    range 0 2
    default 1

config PM_SUPPORT_POWER_EXCEPTION_DEBUG
    bool
    prompt "PM support power exception debug"
    default n

config PM_SUPPORT_SRV_DECOUPLING
    bool
    prompt "PM support service decoupling"
    default n
```

## drivers/chips/ws63/rom/drivers/drivers/driver/sfc/Kconfig
```kconfig
#===============================================================================
# @brief    Kconfig file.
# Copyright (c) HiSilicon (Shanghai) Technologies Co., Ltd. 2022-2022. All rights reserved.
#===============================================================================
config SFC_SUPPORT_DMA
    bool
    prompt "SFC Support DMA"
    default y
    depends on DRIVER_SUPPORT_SFC

config SFC_ALLOW_ERASE_WRITEBACK
    bool
    prompt "Allows Erase at Any Address, needs 4KB RAM at least"
    default n
    depends on DRIVER_SUPPORT_SFC

config SFC_ALREADY_INIT
    bool
    prompt "SFC has been inited, need not to set reg in init/deinit func."
    default n
    depends on DRIVER_SUPPORT_SFC
```
