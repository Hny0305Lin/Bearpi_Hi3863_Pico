## application/Kconfig
```kconfig
#===============================================================================
# @brief    Kconfig file.
# Copyright (c) HiSilicon (Shanghai) Technologies Co., Ltd. 2023-2023. All rights reserved.
#===============================================================================

config SAMPLE_ENABLE
    bool
    prompt "Enable Sample."
    default n
    help
        This option means support Samples.

if SAMPLE_ENABLE
osource "application/samples/Kconfig"
endif
```

## application/samples/Kconfig
```kconfig
#===============================================================================
# @brief    Kconfig file.
# Copyright (c) @CompanyNameMagicTag 2023-2023. All rights reserved.
#===============================================================================

config ENABLE_PERIPHERAL_SAMPLE
    bool
    prompt "Enable the Sample of peripheral."
    default n
    depends on SAMPLE_ENABLE
    help
        This option means enable the sample of peripheral.

if ENABLE_PERIPHERAL_SAMPLE
osource "application/samples/peripheral/Kconfig"
endif

config ENABLE_WIFI_SAMPLE
    bool
    prompt "Enable the Sample of WIFI."
    default n
    depends on SAMPLE_ENABLE
    help
        This option means enable the sample of WIFI.

if ENABLE_WIFI_SAMPLE
osource "application/samples/wifi/Kconfig"
endif

config ENABLE_PRODUCTS_SAMPLE
    bool
    prompt "Enable the Sample of products."
    default n
    depends on SAMPLE_ENABLE
    help
        This option means enable the sample of products.

if ENABLE_PRODUCTS_SAMPLE
osource "application/samples/products/Kconfig"
endif
```

## application/samples/peripheral/Kconfig
```kconfig
#===============================================================================
# @brief    Kconfig file.
# Copyright (c) @CompanyNameMagicTag 2023-2023. All rights reserved.
#===============================================================================
config ENABLE_ALL_PERIPHERAL_SAMPLE
    bool
    prompt "Enable all the sample of peripheral, it's just for build."
    default n
    depends on ENABLE_PERIPHERAL_SAMPLE
    select SAMPLE_SUPPORT_ADC
    select SAMPLE_SUPPORT_BLINKY
    select SAMPLE_SUPPORT_BUTTON
    select SAMPLE_SUPPORT_I2C
    select SAMPLE_SUPPORT_PINCTRL
    select SAMPLE_SUPPORT_PWM
    select SAMPLE_SUPPORT_SPI
    select SAMPLE_SUPPORT_SYSTICK
    select SAMPLE_SUPPORT_TASKS
    select SAMPLE_SUPPORT_TCXO
    select SAMPLE_SUPPORT_TIMER
    select SAMPLE_SUPPORT_UART
    select SAMPLE_SUPPORT_WDT
    help
        This option means enable all the sample of peripheral, it is just for build.

config SAMPLE_SUPPORT_ADC
    bool
    prompt "Support ADC Sample."
    default n
    depends on ENABLE_PERIPHERAL_SAMPLE
    help
        This option means support ADC Sample.

if SAMPLE_SUPPORT_ADC
menu "ADC Sample Configuration"
    osource "application/samples/peripheral/adc/Kconfig"
endmenu
endif


config SAMPLE_SUPPORT_BLINKY
    bool
    prompt "Support BLINKY Sample."
    default n
    depends on ENABLE_PERIPHERAL_SAMPLE
    help
        This option means support BLINKY Sample.

if SAMPLE_SUPPORT_BLINKY
menu "BLINK Sample Configuration"
    osource "application/samples/peripheral/blinky/Kconfig"
endmenu
endif

config SAMPLE_SUPPORT_BUTTON
    bool
    prompt "Support BUTTON Sample."
    default n
    depends on ENABLE_PERIPHERAL_SAMPLE
    help
        This option means support BUTTON Sample.
if SAMPLE_SUPPORT_BUTTON
menu "BUTTON Sample Configuration"
    osource "application/samples/peripheral/button/Kconfig"
endmenu
endif


config SAMPLE_SUPPORT_I2C
    bool
    prompt "Support I2C Sample."
    default n
    depends on ENABLE_PERIPHERAL_SAMPLE
    help
        This option means support I2C Sample.

if SAMPLE_SUPPORT_I2C
menu "I2C Sample Configuration"
    osource "application/samples/peripheral/i2c/Kconfig"
endmenu
endif

config SAMPLE_SUPPORT_PINCTRL
    bool
    prompt "Support PINCTRL Sample."
    default n
    depends on ENABLE_PERIPHERAL_SAMPLE
    help
        This option means support PINCTRL Sample.

if SAMPLE_SUPPORT_PINCTRL
menu "PINCTRL Sample Configuration"
    osource "application/samples/peripheral/pinctrl/Kconfig"
endmenu
endif

config SAMPLE_SUPPORT_PWM
    bool
    prompt "Support PWM Sample."
    default n
    depends on ENABLE_PERIPHERAL_SAMPLE
    help
        This option means support PWM Sample.


config SAMPLE_SUPPORT_SPI
    bool
    prompt "Support SPI Sample."
    default n
    depends on ENABLE_PERIPHERAL_SAMPLE
    help
        This option means support SPI Sample.

if SAMPLE_SUPPORT_SPI
menu "SPI Sample Configuration"
    osource "application/samples/peripheral/spi/Kconfig"
endmenu
endif

config SAMPLE_SUPPORT_SYSTICK
    bool
    prompt "Support SYSTICK Sample."
    default n
    depends on ENABLE_PERIPHERAL_SAMPLE
    help
        This option means support SYSTICK Sample.

config SAMPLE_SUPPORT_TASKS
    bool
    prompt "Support TASKS Test Sample."
    default n
    depends on ENABLE_PERIPHERAL_SAMPLE
    help
        This option means support TASKS Test Sample.

config SAMPLE_SUPPORT_TCXO
    bool
    prompt "Support TCXO Sample."
    default n
    depends on ENABLE_PERIPHERAL_SAMPLE
    help
        This option means support TCXO Sample.

config SAMPLE_SUPPORT_TIMER
    bool
    prompt "Support TIMER Sample."
    default n
    depends on ENABLE_PERIPHERAL_SAMPLE
    help
        This option means support TIMER Sample.

if SAMPLE_SUPPORT_TIMER
menu "TIMER Sample Configuration"
    osource "application/samples/peripheral/timer/Kconfig"
endmenu
endif

config SAMPLE_SUPPORT_UART
    bool
    prompt "Support UART Sample."
    default n
    depends on ENABLE_PERIPHERAL_SAMPLE
    help
        This option means support UART Sample.

if SAMPLE_SUPPORT_UART
menu "UART Sample Configuration"
    osource "application/samples/peripheral/uart/Kconfig"
endmenu
endif

config SAMPLE_SUPPORT_WDT
    bool
    prompt "Support WATCHDOG Sample."
    default n
    depends on ENABLE_PERIPHERAL_SAMPLE
    help
        This option means support WATCHDOG Sample.

if SAMPLE_SUPPORT_WDT
menu "WATCHDOG Sample Configuration"
    osource "application/samples/peripheral/watchdog/Kconfig"
endmenu
endif
```

## application/samples/peripheral/button/Kconfig
```kconfig
#===============================================================================
# @brief    Kconfig file.
# Copyright (c) @CompanyNameMagicTag 2023-2023. All rights reserved.
#===============================================================================

config BUTTON_PIN
    int
    prompt "Choose BUTTON_PIN pin."
    depends on SAMPLE_SUPPORT_BUTTON
    default 0
```

## application/samples/peripheral/i2c/Kconfig
```kconfig
#===============================================================================
# @brief    Kconfig file.
# Copyright (c) @CompanyNameMagicTag 2023-2023. All rights reserved.
#===============================================================================
config SAMPLE_SUPPORT_I2C_MASTER
    bool
    prompt "Support I2C Master Sample."
    default y
    depends on SAMPLE_SUPPORT_I2C
    help
        This option means support I2C Master Sample.

config I2C_MASTER_BUS_ID
    int
    prompt "Choose I2C master bus id."
    depends on SAMPLE_SUPPORT_I2C_MASTER
    default 1

config I2C_SCL_MASTER_PIN
    int
    prompt "Choose I2C SCL master pin."
    depends on SAMPLE_SUPPORT_I2C_MASTER
    default 15

config I2C_SDA_MASTER_PIN
    int
    prompt "Choose I2C SDA master pin."
    depends on SAMPLE_SUPPORT_I2C_MASTER
    default 16
```

## application/samples/peripheral/pinctrl/Kconfig
```kconfig
#===============================================================================
# @brief    Kconfig file.
# Copyright (c) @CompanyNameMagicTag 2023-2023. All rights reserved.
#===============================================================================
config PINCTRL_USE_PIN
    int
    prompt "Choose Pinctrl use pin."
    depends on SAMPLE_SUPPORT_PINCTRL
    default 2
```

## application/samples/peripheral/pwm/Kconfig
```kconfig
#===============================================================================
# @brief    Kconfig file.
# Copyright (c) @CompanyNameMagicTag 2023-2023. All rights reserved.
#===============================================================================

config PWM_PIN
int
    prompt "Choose PWM pin."
    depends on SAMPLE_SUPPORT_PWM
    default 2
```

## application/samples/peripheral/spi/Kconfig
```kconfig
#===============================================================================
# @brief    Kconfig file.
# Copyright (c) @CompanyNameMagicTag 2023-2023. All rights reserved.
#===============================================================================
config SAMPLE_SUPPORT_SPI_MASTER
    bool
    prompt "Support SPI Master Sample."
    default y
    depends on SAMPLE_SUPPORT_SPI
    help
        This option means support SPI Master Sample.

config SPI_MASTER_BUS_ID
    int
    prompt "Choose SPI master bus id."
    depends on SAMPLE_SUPPORT_SPI_MASTER
    default 0

config SPI_DI_MASTER_PIN
    int
    prompt "Choose SPI DI master pin."
    depends on SAMPLE_SUPPORT_SPI_MASTER
    default 11

config SPI_DO_MASTER_PIN
    int
    prompt "Choose SPI DO master pin."
    depends on SAMPLE_SUPPORT_SPI_MASTER
    default 9

config SPI_CLK_MASTER_PIN
    int
    prompt "Choose SPI CLK master pin."
    depends on SAMPLE_SUPPORT_SPI_MASTER
    default 7

config SPI_CS_MASTER_PIN
    int
    prompt "Choose SPI CS master pin."
    depends on SAMPLE_SUPPORT_SPI_MASTER
    default 8

config OLED_RES_PIN
    int
    prompt "Choose OLED RES pin."
    depends on SAMPLE_SUPPORT_SPI_MASTER
    default 6

config OLED_DC_PIN
    int
    prompt "Choose OLED DC pin."
    depends on SAMPLE_SUPPORT_SPI_MASTER
    default 10
```

## application/samples/peripheral/uart/Kconfig
```kconfig
#===============================================================================
# @brief    Kconfig file.
# Copyright (c) @CompanyNameMagicTag 2023-2023. All rights reserved.
#===============================================================================
config UART_BUS_ID
    int
    prompt "Choose UART bus id."
    depends on SAMPLE_SUPPORT_UART
    default 1

config UART_TXD_PIN
    int
    prompt "Choose UART TXD pin."
    depends on SAMPLE_SUPPORT_UART
    default 15

config UART_RXD_PIN
    int
    prompt "Choose UART RXD pin."
    depends on SAMPLE_SUPPORT_UART
    default 16

config UART_POLL_TRANSFER_MODE
    bool
    prompt "Choose UART poll transfer mode."
    depends on SAMPLE_SUPPORT_UART
    default y

config UART_INT_TRANSFER_MODE
    bool
    prompt "Choose UART interrupt transfer mode."
    depends on SAMPLE_SUPPORT_UART
    default n
```

## application/samples/peripheral/watchdog/Kconfig
```kconfig
#===============================================================================
# @brief    Kconfig file.
# Copyright (c) @CompanyNameMagicTag 2023-2023. All rights reserved.
#===============================================================================
config WDT_TIMEOUT_SAMPLE
    bool
    prompt "Choose watchdog kick timeout."
    depends on SAMPLE_SUPPORT_WDT
    default n

config WDT_KICK_SAMPLE
    bool
    prompt "Choose watchdog kick normally."
    depends on SAMPLE_SUPPORT_WDT
    default y
```

## application/samples/products/Kconfig
```kconfig
#===============================================================================
# @brief    Kconfig file.
# Copyright (c) @CompanyNameMagicTag 2023-2023. All rights reserved.
#===============================================================================
config ENABLE_ALL_PRODUCTS_SAMPLE
    bool
    prompt "Enable all the sample of product, it's just for build."
    default n
    depends on ENABLE_PRODUCTS_SAMPLE
    select SAMPLE_SUPPORT_BLE_UART
    select SAMPLE_SUPPORT_SLE_UART
    select SAMPLE_SUPPORT_SLE_GETAWAY
    help
        This option means enable all the sample of product, it is just for build.



config SAMPLE_SUPPORT_BLE_UART
    bool
    prompt "Support BLE UART sample."
    default n
    depends on ENABLE_PRODUCTS_SAMPLE
    help
        This option means support BLE UART Sample.

if SAMPLE_SUPPORT_BLE_UART
menu "BLE UART Sample Configuration"
    osource "application/samples/products/ble_uart/Kconfig"
endmenu
endif



config SAMPLE_SUPPORT_SLE_UART
    bool
    prompt "Support SLE UART sample."
    default n
    depends on ENABLE_PRODUCTS_SAMPLE
    help
        This option means support SLE UART Sample.

if SAMPLE_SUPPORT_SLE_UART
menu "SLE UART Sample Configuration"
    osource "application/samples/products/sle_uart/Kconfig"
endmenu
endif

config SAMPLE_SUPPORT_SLE_GETAWAY
    bool
    prompt "Support SLE GATEWAY sample."
    default n
    depends on ENABLE_PRODUCTS_SAMPLE
    help
        This option means support SLE GATEWAY Sample.

if SAMPLE_SUPPORT_SLE_GETAWAY
menu "SLE GATEWAY Sample Configuration"
    osource "application/samples/products/sle_gateway/Kconfig"
endmenu
endif
```

## application/samples/products/ble_uart/Kconfig
```kconfig
#===============================================================================
# @brief    Kconfig file.
# Copyright (c) @CompanyNameMagicTag 2023-2023. All rights reserved.
#===============================================================================

config BLE_UART_BUS
    int
    prompt "Set the UART BUS of the currrent sample."
    default 0
    depends on SAMPLE_SUPPORT_BLE_UART
    help
        This option means the UART BUS of the currrent sample.

choice
      prompt "Select ble uart type"
      default SAMPLE_SUPPORT_BLE_UART_SERVER
      config SAMPLE_SUPPORT_BLE_UART_SERVER
          bool "Enable BLE UART Server sample."
      config SAMPLE_SUPPORT_BLE_UART_CLIENT
          bool "Enable BLE UART Client sample."
endchoice
```

## application/samples/products/sle_gateway/Kconfig
```kconfig
#===============================================================================
# @brief    Kconfig file.
# Copyright (c) @CompanyNameMagicTag 2023-2023. All rights reserved.
#===============================================================================

config SLE_GATEWAY_BUS
    int
    prompt "Set the UART BUS of the currrent sample."
    default 0
    depends on SAMPLE_SUPPORT_SLE_GETAWAY
    help
        This option means the UART BUS of the currrent sample.

config UART_TXD_PIN
    int
    prompt "Choose UART TXD pin."
    depends on SAMPLE_SUPPORT_SLE_GETAWAY
    default 17

config UART_RXD_PIN
    int
    prompt "Choose UART RXD pin."
    depends on SAMPLE_SUPPORT_SLE_GETAWAY
    default 18

choice
    prompt "Select sle uart type"
    default SAMPLE_SUPPORT_SLE_GATEWAY_SERVER
    config SAMPLE_SUPPORT_SLE_GATEWAY_SERVER
        bool "Enable SLE GATEWAY Server sample."
    config SAMPLE_SUPPORT_SLE_GATEWAY_CLIENT
        bool "Enable SLE GATEWAY Client sample."
endchoice

config SUPPORT_SLE_PERIPHERAL
    bool
    default y if (SAMPLE_SUPPORT_SLE_GATEWAY_SERVER)


config SUPPORT_SLE_CENTRAL
    bool
    default y if (SAMPLE_SUPPORT_SLE_GATEWAY_CLIENT)
```
