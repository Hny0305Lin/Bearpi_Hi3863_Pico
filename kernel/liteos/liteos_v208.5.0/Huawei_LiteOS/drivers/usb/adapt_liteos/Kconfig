## kernel/liteos/liteos_v208.5.0/Huawei_LiteOS/targets/Kconfig.hq
```kconfig
config LOSCFG_PLATFORM
    string
    default "npu_v100"           if LOSCFG_PLATFORM_NPU_V100_BBK
    default "npu_v200"           if LOSCFG_PLATFORM_NPU_V200_BE
    default "npu_v200"           if LOSCFG_PLATFORM_NPU_V200_CE || LOSCFG_PLATFORM_NPU_V200_CE_ES
    default "npu_v200"           if LOSCFG_PLATFORM_NPU_V200_LN
    default "npu_v200"           if LOSCFG_PLATFORM_NPU_V200_CPRO
    default "audiodsp_hifi3z"    if LOSCFG_PLATFORM_AUDIODSP_HIFI3Z
    default "audiodsp_hifi3z"    if LOSCFG_PLATFORM_AUDIODSP_HIFI3Z_EMU
    default "audiodsp_linglong"  if LOSCFG_PLATFORM_AUDIODSP_LINGLONG
    default "audiodsp_linglong"  if LOSCFG_PLATFORM_AUDIODSP_LINGLONG_BVP
    default "isp"                if LOSCFG_PLATFORM_ISP_V320
    default "isp"                if LOSCFG_PLATFORM_ISP_V350
    default "isp"                if LOSCFG_PLATFORM_ISP_V360
    default "isp"                if LOSCFG_PLATFORM_ISP_V130
    default "isp"                if LOSCFG_PLATFORM_ISP_V210
    default "sensorhub_arm"      if LOSCFG_PLATFORM_SH_CE || LOSCFG_PLATFORM_SH_BBK
    default "sensorhub_arm"      if LOSCFG_PLATFORM_SH_AN
    default "sensorhub_lx"       if LOSCFG_PLATFORM_SH_CPRO
    default "lpm_v200"           if LOSCFG_PLATFORM_LPM_CE
    default "lpm_v200"           if LOSCFG_PLATFORM_LPM_CPRO
    default "lpm_v200"           if LOSCFG_PLATFORM_LPM_BBK
    default "ivp"                if LOSCFG_PLATFORM_IVP_BBK

config LOSCFG_ISP_R8_COMMON
    bool
    select LOSCFG_ARCH_CORTEX_R8
    select LOSCFG_ARM_GIC_V2
    select LOSCFG_DRIVERS_UART_LITEOS
    select LOSCFG_USING_BOARD_LD

choice
    prompt "Board"
    depends on LOSCFG_FAMILY_HQ
    default LOSCFG_PLATFORM_NPU_V200_BE

config LOSCFG_PLATFORM_NPU_V100_BBK
    bool "npu_v100_bbk"
    select LOSCFG_ARCH_CORTEX_A53
    select LOSCFG_ARM_GIC_V3
    select LOSCFG_ARM_GENERIC_TIMER
    select LOSCFG_DRIVERS_UART_ARM_PL011
    select LOSCFG_DRIVERS_UART_LITEOS
    select LOSCFG_USING_BOARD_LD

config LOSCFG_PLATFORM_NPU_V200_BE
    bool "npu_v200_be"
    select LOSCFG_ARCH_LINXCORE_131
    select LOSCFG_ARM_SP804_TIMER
    select LOSCFG_DRIVERS_UART_VENDOR
    select LOSCFG_USING_BOARD_LD

config LOSCFG_PLATFORM_NPU_V200_CE
    bool "npu_v200_ce"
    select LOSCFG_ARCH_LINXCORE_131
    select LOSCFG_RISCV_HQTIMER_V500
    select LOSCFG_DRIVERS_UART_VENDOR
    select LOSCFG_USING_BOARD_LD

config LOSCFG_PLATFORM_NPU_V200_CE_ES
    bool "npu_v200_ce_es"
    select LOSCFG_ARCH_LINXCORE_131
    select LOSCFG_RISCV_HQTIMER_V500
    select LOSCFG_DRIVERS_UART_VENDOR
    select LOSCFG_USING_BOARD_LD

config LOSCFG_PLATFORM_NPU_V200_LN
    bool "npu_v200_ln"
    select LOSCFG_ARCH_LINXCORE_131
    select LOSCFG_RISCV_HQTIMER_V500
    select LOSCFG_DRIVERS_UART_VENDOR
    select LOSCFG_USING_BOARD_LD

config LOSCFG_PLATFORM_NPU_V200_CPRO
    bool "npu_v200_cpro"
    select LOSCFG_ARCH_LINXCORE_131
    select LOSCFG_RISCV_HQTIMER_V510
    select LOSCFG_DRIVERS_UART_VENDOR
    select LOSCFG_USING_BOARD_LD

config LOSCFG_PLATFORM_AUDIODSP_HIFI3Z
    bool "audiodsp_hifi3z"
    select LOSCFG_USING_BOARD_LD
    select LOSCFG_XTENSA_HIFI3Z
    select LOSCFG_XTENSA_XEA2_TIMER if LOSCFG_TEST
    select LOSCFG_TIMER_VENDOR if !LOSCFG_TEST
    select LOSCFG_XEA2_INT_CONTROLLER
    select LOSCFG_DRIVERS_UART_VENDOR

config LOSCFG_PLATFORM_AUDIODSP_HIFI3Z_EMU
    bool "audiodsp_hifi3z_emu"
    select LOSCFG_USING_BOARD_LD
    select LOSCFG_XTENSA_HIFI3Z
    select LOSCFG_XTENSA_XEA2_TIMER
    select LOSCFG_XEA2_INT_CONTROLLER
    select LOSCFG_DRIVERS_UART_VENDOR

config LOSCFG_PLATFORM_ISP_V320
    bool "isp_v320"
    select LOSCFG_ISP_R8_COMMON
    select LOSCFG_ARM_PRIVATE_TIMER
    select LOSCFG_DRIVERS_UART_HQ_UART_V500

config LOSCFG_PLATFORM_ISP_V350
    bool "isp_v350"
    select LOSCFG_ISP_R8_COMMON
    select LOSCFG_ARM_PRIVATE_TIMER
    select LOSCFG_DRIVERS_UART_HQ_UART_V500

config LOSCFG_PLATFORM_ISP_V360
    bool "isp_v360"
    select LOSCFG_ISP_R8_COMMON
    select LOSCFG_ARM_PRIVATE_TIMER
    select LOSCFG_DRIVERS_UART_HQ_UART_V500

config LOSCFG_PLATFORM_ISP_V130
    bool "isp_v130"
    select LOSCFG_ISP_R8_COMMON
    select LOSCFG_RISCV_HQTIMER_V500
    select LOSCFG_DRIVERS_UART_HQ_UART_V501

config LOSCFG_PLATFORM_ISP_V210
    bool "isp_v210"
    select LOSCFG_ISP_R8_COMMON
    select LOSCFG_ARM_SP804_TIMER
    select LOSCFG_DRIVERS_UART_HQ_UART_V200

config LOSCFG_PLATFORM_AUDIODSP_LINGLONG
    bool "audiodsp_linglong"
    select LOSCFG_ARCH_LINGLONG
    select LOSCFG_USING_BOARD_LD
    select LOSCFG_LINGLONG_IC
    select LOSCFG_DRIVERS_UART_VENDOR

config LOSCFG_PLATFORM_AUDIODSP_LINGLONG_BVP
    bool "audiodsp_linglong bvp"
    select LOSCFG_ARCH_LINGLONG
    select LOSCFG_USING_BOARD_LD
    select LOSCFG_LINGLONG_IC
    select LOSCFG_TIMER_VENDOR
    select LOSCFG_DRIVERS_UART_VENDOR

config LOSCFG_PLATFORM_SH_CE
    bool "sensorhub_ce"
    select LOSCFG_ARCH_CORTEX_M7
    select LOSCFG_ARCH_FPU_VFP_DP
    select LOSCFG_INTERRUPT_VENDOR
    select LOSCFG_TIMER_VENDOR
    select LOSCFG_DRIVERS_UART_VENDOR
    select LOSCFG_USING_BOARD_LD

config LOSCFG_PLATFORM_SH_BBK
    bool "sensorhub_bbk"
    select LOSCFG_ARCH_CORTEX_M7
    select LOSCFG_ARCH_FPU_VFP_DP
    select LOSCFG_INTERRUPT_VENDOR
    select LOSCFG_TIMER_VENDOR
    select LOSCFG_DRIVERS_UART_VENDOR
    select LOSCFG_USING_BOARD_LD

config LOSCFG_PLATFORM_SH_AN
    bool "sensorhub_an"
    select LOSCFG_ARCH_CORTEX_M55
    select LOSCFG_ARCH_FPU_VFP_DP
    select LOSCFG_INTERRUPT_VENDOR
    select LOSCFG_TIMER_VENDOR
    select LOSCFG_DRIVERS_UART_VENDOR
    select LOSCFG_USING_BOARD_LD

config LOSCFG_PLATFORM_SH_CPRO
    bool "sensorhub_cpro"
    select LOSCFG_ARCH_LINXCORE_170
    select LOSCFG_ARCH_RISCV_RV32D
    select LOSCFG_LCMP_CUSTOM_INST16_EXTENSIONS
    select LOSCFG_LCMP_CUSTOM_INST32_EXTENSIONS
    select LOSCFG_TIMER_VENDOR
    select LOSCFG_DRIVERS_UART_VENDOR
    select LOSCFG_USING_BOARD_LD

config LOSCFG_PLATFORM_LPM_CE
    bool "lpm_v200_ce"
    select LOSCFG_INTERRUPT_VENDOR
    select LOSCFG_ARCH_LINXCORE_131
    select LOSCFG_TIMER_VENDOR
    select LOSCFG_DRIVERS_UART_VENDOR
    select LOSCFG_USING_BOARD_LD
    select LOSCFG_USING_BOARD_RESET_VECTOR

config LOSCFG_PLATFORM_LPM_CPRO
    bool "lpm_v200_cpro"
    select LOSCFG_INTERRUPT_VENDOR
    select LOSCFG_ARCH_LINXCORE_131
    select LOSCFG_TIMER_VENDOR
    select LOSCFG_DRIVERS_UART_VENDOR
    select LOSCFG_USING_BOARD_LD
    select LOSCFG_USING_BOARD_RESET_VECTOR

config LOSCFG_PLATFORM_LPM_BBK
    bool "lpm_v200_bbk"
    select LOSCFG_INTERRUPT_VENDOR
    select LOSCFG_ARCH_CORTEX_M3
    select LOSCFG_TIMER_VENDOR
    select LOSCFG_DRIVERS_UART_VENDOR
    select LOSCFG_USING_BOARD_LD
    select LOSCFG_USING_BOARD_RESET_VECTOR

config LOSCFG_PLATFORM_IVP_BBK
    bool "ivp_bbk"
    select LOSCFG_XTENSA_XEA3_TIMER if LOSCFG_TEST
    select LOSCFG_TIMER_VENDOR if !LOSCFG_TEST
    select LOSCFG_XEA3_INT_CONTROLLER
    select LOSCFG_DRIVERS_UART_VENDOR
    select LOSCFG_USING_BOARD_RESET_VECTOR
    select LOSCFG_XTENSA_VISIONQ6_V2
    select LOSCFG_USING_BOARD_LD

endchoice
```

## kernel/liteos/liteos_v208.5.0/Huawei_LiteOS/targets/Kconfig.shc
```kconfig
config LOSCFG_PLATFORM
    string
    default "hi5601_mcu"      if LOSCFG_PLATFORM_HI5601_MCU
    default "hiex"            if LOSCFG_PLATFORM_HIEX || LOSCFG_PLATFORM_HIEX_ES || LOSCFG_PLATFORM_HIEX_NES
    default "suqin_app"       if LOSCFG_PLATFORM_SUQIN_APP
    default "hi1162_app"      if LOSCFG_PLATFORM_HI1162_APP
    default "sushik_app"      if LOSCFG_PLATFORM_SUSHIK_APP

choice
    prompt "Board"
    depends on LOSCFG_FAMILY_SHC
    default LOSCFG_PLATFORM_HI5601_MCU

config LOSCFG_PLATFORM_HI5601_MCU
    bool "hi5601_mcu"
    select LOSCFG_ARCH_LINXCORE_131
    select LOSCFG_TIMER_VENDOR
    select LOSCFG_DRIVERS_UART_VENDOR
    select LOSCFG_USING_BOARD_LD

config LOSCFG_PLATFORM_HIEX
    bool "hiex"
    select LOSCFG_ARCH_CORTEX_M55
    select LOSCFG_CORTEX_M_SYSTICK
    select LOSCFG_USING_BOARD_LD
    select LOSCFG_SCHED_LATENCY
    select LOSCFG_DRIVERS_UART_VENDOR

config LOSCFG_PLATFORM_HIEX_NES
    bool "hiex_nes"
    select LOSCFG_ARCH_CORTEX_M55
    select LOSCFG_CORTEX_M_SYSTICK
    select LOSCFG_USING_BOARD_LD
    select LOSCFG_SCHED_LATENCY
    select LOSCFG_DRIVERS_UART_VENDOR

config LOSCFG_PLATFORM_HIEX_ES
    bool "hiex_es"
    select LOSCFG_ARCH_CORTEX_M55
    select LOSCFG_USING_BOARD_LD
    select LOSCFG_SECURE_REGION
    select LOSCFG_TIMER_VENDOR
    select LOSCFG_INTERRUPT_VENDOR
    select LOSCFG_DRIVERS_UART_VENDOR

config LOSCFG_PLATFORM_SUQIN_APP
    bool "suqin_app"
    select LOSCFG_ARCH_LINXCORE_170
    select LOSCFG_ARCH_RISCV_RV32F
    select LOSCFG_LCMP_CUSTOM_INST16_EXTENSIONS
    select LOSCFG_LCMP_CUSTOM_INST16_SUB_EXTENSIONS
    select LOSCFG_LCMP_CUSTOM_INST32_EXTENSIONS
    select LOSCFG_TIMER_VENDOR
    select LOSCFG_DRIVERS_UART_VENDOR
    select LOSCFG_USING_BOARD_LD
    select LOSCFG_USING_BOARD_RESET_VECTOR

config LOSCFG_PLATFORM_HI1162_APP
    bool "hi1162_app"
    select LOSCFG_ARCH_RISCV_RV32F
    select LOSCFG_ARCH_LINXCORE_131
    select LOSCFG_TIMER_VENDOR
    select LOSCFG_DRIVERS_UART_VENDOR
    select LOSCFG_USING_BOARD_LD
    select LOSCFG_USING_BOARD_RESET_VECTOR

config LOSCFG_PLATFORM_SUSHIK_APP
    bool "sushik_app"
    select LOSCFG_ARCH_CORTEX_M7
    select LOSCFG_CORTEX_M_NVIC
    select LOSCFG_TIMER_VENDOR
    select LOSCFG_DRIVERS_UART_VENDOR
    select LOSCFG_USING_BOARD_LD

endchoice
```

## kernel/osal/Kconfig
```kconfig
#===============================================================================
# @brief    Kconfig file.
# Copyright (c) HiSilicon (Shanghai) Technologies Co., Ltd. 2023-2023. All rights reserved.
#===============================================================================
config DRIVER_DISABLE_OSAL_LOG
    bool
    prompt "disable osal log"
    default n
    help
        This option means turn off osal log.
```

## middleware/Kconfig
```kconfig
#===============================================================================
# @brief    Kconfig file.
# Copyright (c) HiSilicon (Shanghai) Technologies Co., Ltd. 2022-2022. All rights reserved.
#===============================================================================
menu "Chips"
    comment "Config the middleware of chips."
    osource "middleware/chips/Kconfig"
endmenu

menu "Services"
    comment "Config the middleware of service."
    osource "middleware/services/Kconfig"
endmenu

menu "Utils"
    comment "Config the middleware of utils."
    osource "middleware/utils/Kconfig"
endmenu
```

## middleware/chips/Kconfig
```kconfig
#===============================================================================
# @brief    Kconfig file.
# Copyright (c) HiSilicon (Shanghai) Technologies Co., Ltd. 2022-2023. All rights reserved.
#===============================================================================

choice
    prompt "Choose Chip"

config MIDDLEWARE_CHIP_WS53
    bool "ws53"

config MIDDLEWARE_CHIP_WS63
    bool "ws63"

endchoice

if MIDDLEWARE_CHIP_WS53
menu "Chip Configurations for ws53"
    comment "Config ws53"
    osource "middleware/chips/ws53/Kconfig"
endmenu
endif

if MIDDLEWARE_CHIP_WS63
menu "Chip Configurations for ws63"
    comment "Config ws63"
    osource "middleware/chips/ws63/Kconfig"
endmenu
endif
```

## middleware/chips/ws63/Kconfig
```kconfig
#===============================================================================
# @brief    Kconfig file.
# Copyright (c) HiSilicon (Shanghai) Technologies Co., Ltd. 2023-2023. All rights reserved.
#===============================================================================
config MIDDLEWARE_SUPPORT_FTM
    bool
    prompt "FTM"
    default y
    help
        This option means support FTM.

config MIDDLEWARE_SUPPORT_NV
    bool
    prompt "NV"
    default y
    help
        This option means support nv.
config MIDDLEWARE_NV_SUPPORT_HSO_ACCESS
    bool
    depends on MIDDLEWARE_SUPPORT_NV
    prompt "NV Support HSO Access"
    default n
    help
        This option means nv support HSO access.

config PARTITION_FEATURE_SUPPORT
    bool
    depends on MIDDLEWARE_SUPPORT_NV
    prompt "NV Support HSO Access"
    default n
    help
        This option means nv support get addr by partition feature.

config MIDDLEWARE_SUPPORT_UPG
    bool
    prompt "FOTA"
    default y
    help
        This option means support FOTA.

config MIDDLEWARE_SUPPORT_EXCEPT_DISABLE_WDT
    bool
    prompt "Disable wdt after exception"
    default n
    help
        This option means support disable wdt after exception.

choice
depends on MIDDLEWARE_SUPPORT_UPG
    prompt "FOTA TYPE"
    default MIDDLEWARE_SUPPORT_UPG_COMPRESS
    config MIDDLEWARE_SUPPORT_UPG_COMPRESS
        bool
        prompt "FOTA for compress"
        default y
        help
            This option means support FOTA for compress.

    config MIDDLEWARE_SUPPORT_UPG_AB
        bool
        prompt "FOTA for AB"
        default n
        help
            This option means support FOTA for AB plane.
endchoice

config MIDDLEWARE_SUPPORT_UPG_COMPRESS_ENCRY
    bool
    prompt "OTA for compress encry"
    default y
    depends on MIDDLEWARE_SUPPORT_UPG_COMPRESS
    help
        This option means support FOTA for compress encry.

config MIDDLEWARE_SUPPORT_UPG_SAMPLE_VERIFY
    bool
    prompt "OTA for sample verify"
    default n
    depends on MIDDLEWARE_SUPPORT_UPG
    help
        This option means support FOTA for compress encry.

choice
    prompt "EXCEPTION MODE"
config MIDDLEWARE_SUPPORT_EXCEPT_REBOOT
    bool
    prompt "Reboot after exception"
    default y
    help
        This option means support reboot after exception.
config MIDDLEWARE_SUPPORT_EXCEPT_WAITFOREVER
    bool
    prompt "Wait forever after exception"
    default n
    help
        This option means support wait forever after exception.
endchoice

config MIDDLEWARE_SUPPORT_LFS
    bool
    prompt "littlefs adapt"
    default n
    help
        This option means support little file system.
config LFS_PARTITION_ID
    int
    depends on MIDDLEWARE_SUPPORT_LFS
    prompt "littlefs flash partition ID"
    default 0x21
    help
        This option means support little file system partition ID.
config LFS_ADAPT_DEBUG
    bool
    depends on MIDDLEWARE_SUPPORT_LFS
    prompt "littlefs adapt debug print"
    default n
    help
        This option means support little file system debug print.
config LFS_ADAPT_WARN
    bool
    depends on MIDDLEWARE_SUPPORT_LFS
    prompt "littlefs adapt warn print"
    default n
    help
        This option means support little file system warn print.
config LFS_ADAPT_ERROR
    bool
    depends on MIDDLEWARE_SUPPORT_LFS
    prompt "littlefs adapt error print"
    default y
    help
        This option means support little file system error print.
config SUPPORT_CRASHINFO_SAVE_TO_FLASH
    bool
    prompt "save crash info into flash"
    default n
```

## middleware/services/Kconfig
```kconfig
config MIDDLEWARE_SUPPORT_TIOT
    bool
    prompt "TIoT porting"
    default n
    help
        This option means support TIoT.

if MIDDLEWARE_SUPPORT_TIOT
menu "TIoT porting Configuration"
    comment "Config TIoT porting"
    osource  "middleware/services/srv_tiot_host/Kconfig"
endmenu
endif
```
