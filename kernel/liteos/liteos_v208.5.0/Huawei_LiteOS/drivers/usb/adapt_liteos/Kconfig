## kernel/liteos/liteos_v208.5.0/Huawei_LiteOS/kernel/base/mem/Kconfig
```kconfig
menu "Memory Management"

config LOSCFG_KERNEL_MEM_ALLOC
    bool "Dynamic Memory Management"
    default y

if LOSCFG_KERNEL_MEM_ALLOC
choice
    prompt "Dynamic Memory Management Algorithm"
    default LOSCFG_KERNEL_MEM_BESTFIT

config LOSCFG_KERNEL_MEM_BESTFIT
    bool "bestfit"
    help
      This option will change mem type as bestfit

config LOSCFG_KERNEL_MEM_BESTFIT_LITTLE
    bool "bestfit_little"
    help
      This option will change mem type as bestfit little
endchoice

config LOSCFG_KERNEL_MEM_SLAB_EXTENTION
    bool "Enable Mem SLAB Extention"
    default n
    depends on LOSCFG_KERNEL_MEM_ALLOC

config LOSCFG_KERNEL_MEM_SLAB_AUTO_EXPANSION_MODE
    bool "Enable Mem SLAB Auto Expansion Mode"
    default n
    depends on LOSCFG_KERNEL_MEM_SLAB_EXTENTION

config LOSCFG_MEM_TASK_STAT
    bool "Enable Memory Task Usage Statistics"
    default y
    depends on LOSCFG_KERNEL_MEM_ALLOC
    help
      Answer Y to enable LiteOS support memory task statistics

config LOSCFG_MEM_MUL_MODULE
    bool "Enable Memory module statistics"
    default n
    depends on LOSCFG_KERNEL_MEM_BESTFIT
    help
      Answer Y to enable LiteOS support memory statistics depend on different module
endif

config LOSCFG_KERNEL_MEMBOX
    bool "Membox Management"
    default y

choice
    prompt "Membox Management Algorithm"
    default LOSCFG_KERNEL_MEMBOX_STATIC
    depends on LOSCFG_KERNEL_MEMBOX

config LOSCFG_KERNEL_MEMBOX_STATIC
    bool "static memory"
    help
      This option will change membox implemented with input memory

config LOSCFG_KERNEL_MEMBOX_DYNAMIC
    bool "dynamic memory"
    depends on LOSCFG_KERNEL_MEM_ALLOC
    help
      This option will change membox implemented with dynamic allocated memory

endchoice

endmenu
```

## kernel/liteos/liteos_v208.5.0/Huawei_LiteOS/lib/Kconfig
```kconfig
menu "Lib"

config LOSCFG_LIB_LIBSEC
    bool "Enable LibSec"
    default y
    help
      Answer Y to enable LiteOS support secure c.

config LOSCFG_LIB_LIBC
    bool "Enable Libc"
    default y
    depends on !LOSCFG_ARCH_XTENSA
    help
      Answer Y to enable LiteOS support libc.

menuconfig LOSCFG_COMPAT_POSIX
    bool "Enable Posix"
    default y
    depends on LOSCFG_LIB_LIBC
    select LOSCFG_TASK_JOINABLE
    select LOSCFG_KERNEL_MEM_ALLOC
    select LOSCFG_BASE_IPC_MUX
    select LOSCFG_BASE_IPC_SEM
    select LOSCFG_BASE_IPC_EVENT
    select LOSCFG_BASE_CORE_SWTMR
    select LOSCFG_BASE_IPC_QUEUE
    select LOSCFG_QUEUE_DYNAMIC_ALLOCATION
    select LOSCFG_TASK_STACK_DYNAMIC_ALLOCATION
    help
      Answer Y to enable LiteOS support posix interface.

config LOSCFG_LIB_VENDORNAME
    string "User-defined nodename for uname"
    default "vendor"
    depends on LOSCFG_COMPAT_POSIX
    help
      Config nodename for uname api, default is "vendor".

config LOSCFG_LIB_LIBM
    bool "Enable Math"
    default y
    depends on LOSCFG_LIB_LIBC
    help
      Answer Y to enable LiteOS support math function.

config LOSCFG_LIB_FORMAT
    bool "Enable Format"
    default y
    depends on LOSCFG_LIB_LIBC
    select LOSCFG_LIB_LIBM
    help
      Answer Y to enable LiteOS support format function.

config LOSCFG_LIB_STDIO
    bool "Enable Stdio"
    default y
    depends on LOSCFG_LIB_LIBC && LOSCFG_FS_VFS
    select LOSCFG_LIB_FORMAT
    select LOSCFG_COMPAT_POSIX
    select LOSCFG_LIB_LIBM
    help
      Answer Y to enable LiteOS support I/O function.

config LOSCFG_SUPPORT_LONG_DOUBLE
    bool "Support Long Double Float Type"
    default y
    depends on LOSCFG_LIB_STDIO || LOSCFG_LIB_LIBM || LOSCFG_COMPAT_POSIX || LOSCFG_LIB_FORMAT
    help
      Answer Y to enable LiteOS support long double float type.

endmenu
```

## kernel/liteos/liteos_v208.5.0/Huawei_LiteOS/shell/Kconfig
```kconfig
config LOSCFG_SHELL
    bool "Enable Shell"
    default n
    depends on LOSCFG_DEBUG_VERSION
    help
      Answer Y to enable LiteOS support shell cmd.

choice
    prompt "Select Shell Input"
    default LOSCFG_SHELL_CONSOLE
    depends on LOSCFG_SHELL
    help
      Select shell input, when the input source is chosen, the shell will read the
      terminal input from the source.

config LOSCFG_SHELL_CONSOLE
    bool "Console"
    depends on LOSCFG_KERNEL_CONSOLE
    help
      The shell will use the console to interact with the drivers.

config LOSCFG_SHELL_UART
    bool "Uart"
    depends on LOSCFG_DRIVERS_UART || LOSCFG_DRIVERS_UART_VENDOR
    help
      The shell will directly interact with the uart drivers, and only one input
      source is supported.

endchoice

if !LOSCFG_SAFETY_KERNEL

config LOSCFG_SHELL_EXTENDED_CMDS
    bool "Enable Shell Ext CMDs"
    default n
    depends on LOSCFG_DEBUG_VERSION && LOSCFG_SHELL
    select LOSCFG_COMPAT_POSIX
    help
      Answer Y to enable LiteOS support shell extended cmds.

config LOSCFG_SHELL_LK
    bool "Enable Shell LK"
    default y
    depends on LOSCFG_DEBUG_VERSION && LOSCFG_SHELL && LOSCFG_FS_VFS
    help
      Answer Y to enable LiteOS support shell lk.

config LOSCFG_SHELL_DMESG
    bool "Enable Shell DMESG"
    default n
    depends on LOSCFG_DEBUG_VERSION && LOSCFG_SHELL
    select LOSCFG_KERNEL_PRINTF
    help
      Answer Y to enable LiteOS support shell dmesg.

endif # !LOSCFG_SAFETY_KERNEL

config LOSCFG_SHELL_USER_TEXT
    bool
    default y
    depends on LOSCFG_SAFETY_KERNEL && LOSCFG_BOX && LOSCFG_SHELL

config LOSCFG_SHELL_WITH_CB
    bool
    default y
    depends on LOSCFG_SAFETY_KERNEL && LOSCFG_BOX && LOSCFG_SHELL
```

## kernel/liteos/liteos_v208.5.0/Huawei_LiteOS/targets/Kconfig
```kconfig
choice
    prompt "Family"

config LOSCFG_FAMILY_BVT
    bool "BVT"

config LOSCFG_FAMILY_DPT
    bool "DPT"

config LOSCFG_FAMILY_AIOT
    bool "AIOT"

config LOSCFG_FAMILY_STB
    bool "STB"

config LOSCFG_FAMILY_QEMU
    bool "QEMU"

config LOSCFG_FAMILY_STM32
    bool "STM32"

config LOSCFG_FAMILY_SECRET
    bool "SECRET"

config LOSCFG_FAMILY_HQ
    bool "HQ"

config LOSCFG_FAMILY_ENERGY
    bool "ENERGY"

config LOSCFG_FAMILY_SHC
    bool "SHC"

config LOSCFG_FAMILY_ASCEND
    bool "ASCEND"

endchoice

config LOSCFG_FAMILY
    string
    default "aiot" if LOSCFG_FAMILY_AIOT

osource "targets/Kconfig.bvt"
osource "targets/Kconfig.dpt"
osource "targets/Kconfig.aiot"
osource "targets/Kconfig.stb"
osource "targets/Kconfig.qemu"
osource "targets/Kconfig.stm32"
osource "targets/Kconfig.secret"
osource "targets/Kconfig.hq"
osource "targets/Kconfig.energy"
osource "targets/Kconfig.shc"
osource "targets/Kconfig.ascend"

config LOSCFG_PLATFORM_ASCEND
    bool
    select LOSCFG_ARM_GENERIC_TIMER
    select LOSCFG_ARM_GIC_V3
    select LOSCFG_USING_BOARD_LD
    select LOSCFG_DRIVERS_UART_LITEOS
    select LOSCFG_DRIVERS_UART_ARM_PL011
    help
        This is genenel setup for 64bit ARMv8 based ascend platforms which should directly
        select this option and add specific processor cores.


config LOSCFG_PLATFORM_HISI_BVT_ARM
    bool
    select LOSCFG_ARM_GIC_V2
    select LOSCFG_ARM_GENERIC_TIMER
    select LOSCFG_ARM_SP804_HRTIMER
    select LOSCFG_DRIVERS_UART_ARM_PL011
    select LOSCFG_DRIVERS_UART_LINUX
    help
        This is genenel setup for 32bit ARMv7/8 based platforms which should directly
        select this option and add specific processor cores. For example:

        config LOSCFG_PLATFORM_HI35xxVxxx
            bool "HI35xxVxxx"
            select LOSCFG_ARCH_CORTEX_A7
            select LOSCFG_PLATFORM_HISI_BVT_ARM

config LOSCFG_PLATFORM_HISI_RISCV
    bool
    select LOSCFG_ARCH_LINXCORE_131
    select LOSCFG_ARM_SP804_TIMER
    select LOSCFG_DRIVERS_UART_ARM_PL011
    help
        This is genenel setup for risc-v based hisilicon platforms which should directly
        select this option and add specific processor cores.

config LOSCFG_USING_BOARD_LD
    bool

config LOSCFG_USING_BOARD_RESET_VECTOR
    bool
    default n
    help
        Use board reset vector instead of arch default implementation.

config LOSCFG_USING_GCC_NOPIC_LIB
    bool
    default n
    depends on LOSCFG_PLATFORM_HI3892_SE
    help
        When the platform is RISCV, the gcc library is changed to gcc-nopic.
```

## kernel/liteos/liteos_v208.5.0/Huawei_LiteOS/targets/Kconfig.aiot
```kconfig
config LOSCFG_PLATFORM
    string
    default "bs21"            if LOSCFG_PLATFORM_BS21
    default "cat1"            if LOSCFG_PLATFORM_CAT1
    default "bs25"            if LOSCFG_PLATFORM_BS25
    default "ws63"            if LOSCFG_PLATFORM_WS63
    default "ws53"            if LOSCFG_PLATFORM_WS53
    default "suqin_app"       if LOSCFG_PLATFORM_SUQIN_APP
    default "sushik_app"      if LOSCFG_PLATFORM_SUSHIK_APP
    default "socmn1"          if LOSCFG_PLATFORM_SOCMN1
    default "sw39_bt"         if LOSCFG_PLATFORM_SW39_BT
    default "sw21_bt"         if LOSCFG_PLATFORM_SW21_BT

choice
    prompt "Board"
    depends on LOSCFG_FAMILY_AIOT
    default LOSCFG_PLATFORM_BS25

config LOSCFG_PLATFORM_BS21
    bool "bs21"
    select LOSCFG_ARCH_LINXCORE_131
    select LOSCFG_ARCH_RISCV_RV32IMC
    select LOSCFG_RISCV_HIMIDEERV200_PLIC
    select LOSCFG_TIMER_VENDOR
    select LOSCFG_DRIVERS_UART_VENDOR
    select LOSCFG_USING_BOARD_LD
    select LOSCFG_ARCH_RISCV_RV32F
    select LOSCFG_ARCH_RISCV32
    select LOSCFG_USING_BOARD_RESET_VECTOR

config LOSCFG_PLATFORM_CAT1
    bool "cat1"
    select LOSCFG_ARCH_LINXCORE_170
    select LOSCFG_ARCH_RISCV_RV32IMC
    select LOSCFG_RISCV_LCMP_CLIC
    select LOSCFG_TIMER_VENDOR
    select LOSCFG_DRIVERS_UART_VENDOR
    select LOSCFG_USING_BOARD_LD
    select LOSCFG_ARCH_RISCV_RV32F
    select LOSCFG_ARCH_RISCV32
    select LOSCFG_USING_BOARD_RESET_VECTOR

config LOSCFG_PLATFORM_BS25
    bool "bs25"
    select LOSCFG_ARCH_LINXCORE_131
    select LOSCFG_ARCH_RISCV_RV32IMC
    select LOSCFG_RISCV_HIMIDEERV200_PLIC
    select LOSCFG_TIMER_VENDOR
    select LOSCFG_DRIVERS_UART_VENDOR
    select LOSCFG_USING_BOARD_LD
    select LOSCFG_ARCH_RISCV_RV32F
    select LOSCFG_ARCH_RISCV32
    select LOSCFG_USING_BOARD_RESET_VECTOR

config LOSCFG_PLATFORM_WS63
    bool "ws63"
    select LOSCFG_ARCH_RISCV_RV32IMC
    select LOSCFG_ARCH_LINXCORE_131
    select LOSCFG_RISCV_HIMIDEERV200_PLIC
    select LOSCFG_TIMER_VENDOR
    select LOSCFG_DRIVERS_UART_VENDOR
    select LOSCFG_USING_BOARD_LD
    select LOSCFG_ARCH_RISCV_RV32F
    select LOSCFG_ARCH_RISCV32
    select LOSCFG_USING_BOARD_RESET_VECTOR

config LOSCFG_PLATFORM_WS53
    bool "ws53"
    select LOSCFG_ARCH_RISCV_RV32IMC
    select LOSCFG_ARCH_LINXCORE_131
    select LOSCFG_RISCV_HIMIDEERV200_PLIC
    select LOSCFG_TIMER_VENDOR
    select LOSCFG_DRIVERS_UART_VENDOR
    select LOSCFG_USING_BOARD_LD
    select LOSCFG_ARCH_RISCV_RV32F
    select LOSCFG_ARCH_RISCV32
    select LOSCFG_USING_BOARD_RESET_VECTOR
    
config LOSCFG_PLATFORM_SUQIN_APP
    bool "suqin_app"
    select LOSCFG_ARCH_LINXCORE_170
    select LOSCFG_ARCH_RISCV_RV32F
    select LOSCFG_LCMP_CUSTOM_INST16_EXTENSIONS
    select LOSCFG_LCMP_CUSTOM_INST16_SUB_EXTENSIONS
    select LOSCFG_LCMP_CUSTOM_INST32_EXTENSIONS
    select LOSCFG_TIMER_VENDOR
    select LOSCFG_DRIVERS_UART_VENDOR
    select LOSCFG_USING_BOARD_LD
    select LOSCFG_USING_BOARD_RESET_VECTOR

config LOSCFG_PLATFORM_SOCMN1
    bool "socmn1"
    select LOSCFG_ARCH_CORTEX_M7
    select LOSCFG_ARCH_FPU_VFP_DP
    select LOSCFG_CORTEX_M_SYSTICK
    select LOSCFG_USING_BOARD_LD
    select LOSCFG_DRIVERS_UART_VENDOR

config LOSCFG_PLATFORM_SW39_BT
    bool "sw39_bt"
    select LOSCFG_ARCH_LINXCORE_170
    select LOSCFG_ARCH_RISCV_RV32F
    select LOSCFG_LCMP_CUSTOM_INST16_EXTENSIONS
    select LOSCFG_LCMP_CUSTOM_INST16_SUB_EXTENSIONS
    select LOSCFG_LCMP_CUSTOM_INST32_EXTENSIONS
    select LOSCFG_TIMER_VENDOR
    select LOSCFG_DRIVERS_UART_VENDOR
    select LOSCFG_USING_BOARD_LD
    select LOSCFG_USING_BOARD_RESET_VECTOR

config LOSCFG_PLATFORM_SW21_BT
    bool "sw21_bt"
    select LOSCFG_ARCH_LINXCORE_170
    select LOSCFG_ARCH_RISCV_RV32F
    select LOSCFG_LCMP_CUSTOM_INST16_EXTENSIONS
    select LOSCFG_LCMP_CUSTOM_INST16_SUB_EXTENSIONS
    select LOSCFG_LCMP_CUSTOM_INST32_EXTENSIONS
    select LOSCFG_TIMER_VENDOR
    select LOSCFG_DRIVERS_UART_VENDOR
    select LOSCFG_USING_BOARD_LD
    select LOSCFG_USING_BOARD_RESET_VECTOR

endchoice
```

## kernel/liteos/liteos_v208.5.0/Huawei_LiteOS/targets/Kconfig.ascend
```kconfig
config LOSCFG_PLATFORM
    string
    default "hi1980_imu"         if LOSCFG_PLATFORM_HI1980_IMU
    default "hi1980b_imu"        if LOSCFG_PLATFORM_HI1980B_IMU
    default "hi1980b_ffts"       if LOSCFG_PLATFORM_HI1980B_FFTS
    default "hi1910b_tsch"       if LOSCFG_PLATFORM_HI1910B_TSCH
    default "hi1980b_tsch"       if LOSCFG_PLATFORM_HI1980B_TSCH
    default "hi1980b_vdec"       if LOSCFG_PLATFORM_HI1980B_VDEC
    default "hi1980_tsch"        if LOSCFG_PLATFORM_HI1980_TSCH
    default "hi1910_tsch"        if LOSCFG_PLATFORM_HI1910_TSCH
    default "hi1910p_tsch"       if LOSCFG_PLATFORM_HI1910P_TSCH

choice
    prompt "Board"
    depends on LOSCFG_FAMILY_ASCEND
    default LOSCFG_PLATFORM_HI1980_IMU

config LOSCFG_PLATFORM_HI1980_IMU
    bool "hi1980_imu"
    select LOSCFG_ARCH_CORTEX_A53
    select LOSCFG_PLATFORM_ASCEND

config LOSCFG_PLATFORM_HI1980B_IMU
    bool "hi1980b_imu"
    select LOSCFG_ARCH_CORTEX_A53
    select LOSCFG_PLATFORM_ASCEND

config LOSCFG_PLATFORM_HI1980B_FFTS
    bool "hi1980b_ffts"
    select LOSCFG_ARCH_CORTEX_A53
    select LOSCFG_PLATFORM_ASCEND
    select LOSCFG_ARM_GIC_LPI_ENABLE

config LOSCFG_PLATFORM_HI1910B_TSCH
    bool "hi1910b_tsch"
    select LOSCFG_ARCH_CORTEX_A53
    select LOSCFG_PLATFORM_ASCEND
    select LOSCFG_ARM_GIC_LPI_ENABLE

config LOSCFG_PLATFORM_HI1980B_TSCH
    bool "hi1980b_tsch"
    select LOSCFG_ARCH_CORTEX_A53
    select LOSCFG_PLATFORM_ASCEND
    select LOSCFG_ARM_GIC_LPI_ENABLE

config LOSCFG_PLATFORM_HI1980B_VDEC
    bool "hi1980b_vdec"
    select LOSCFG_ARCH_CORTEX_A53
    select LOSCFG_PLATFORM_ASCEND
    select LOSCFG_ARM_GIC_LPI_ENABLE

config LOSCFG_PLATFORM_HI1980_TSCH
    bool "hi1980_tsch"
    select LOSCFG_ARCH_RAS
    select LOSCFG_ARCH_CORTEX_A53
    select LOSCFG_PLATFORM_ASCEND
    select LOSCFG_ARM_GIC_LPI_ENABLE

config LOSCFG_PLATFORM_HI1910_TSCH
    bool "hi1910_tsch"
    select LOSCFG_ARCH_CORTEX_A53
    select LOSCFG_PLATFORM_ASCEND

config LOSCFG_PLATFORM_HI1910P_TSCH
    bool "hi1910p_tsch"
    select LOSCFG_ARCH_CORTEX_R52
    select LOSCFG_PLATFORM_ASCEND
endchoice
```
