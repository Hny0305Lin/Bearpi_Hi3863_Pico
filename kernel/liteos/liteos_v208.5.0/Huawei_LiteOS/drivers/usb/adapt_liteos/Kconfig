## middleware/utils/Kconfig
```kconfig
#===============================================================================
# @brief    Kconfig file.
# Copyright (c) HiSilicon (Shanghai) Technologies Co., Ltd. 2022-2023. All rights reserved.
#===============================================================================
config MIDDLEWARE_SUPPORT_PM
    bool
    prompt "PM"
    default y
    help
        This option means support pm.

if MIDDLEWARE_SUPPORT_PM
menu "PM Configuration"
    comment "Config PM"
    osource  "middleware/utils/pm/Kconfig"
endmenu
endif

config MIDDLEWARE_SUPPORT_DFX
    bool
    prompt "DFX"
    default y
    help
        This option means support dfx.

if MIDDLEWARE_SUPPORT_DFX
menu "Design for Maintainable and Testable Configuration"
    comment "Config DFM & DFT"
    osource  "middleware/utils/dfx/Kconfig"
endmenu
endif

config MIDDLEWARE_SUPPORT_AT
    bool
    prompt "AT"
    default y
    help
        This option means support at command.

if MIDDLEWARE_SUPPORT_AT
menu "Config AT"
    comment "Config AT"
    osource  "middleware/utils/at/Kconfig"
endmenu
endif

config MIDDLEWARE_SUPPORT_CODEC
    bool
    prompt "Codec"
    default n
    help
        This option means support codec.

if MIDDLEWARE_SUPPORT_CODEC
menu "Config Codec"
    comment "Config Codec"
    osource "middleware/utils/codec/Kconfig"
endmenu
endif

config MIDDLEWARE_SUPPORT_UPDATE
    bool
    prompt "Update Config"
    default n
    help
        This option means support bt upg.

if MIDDLEWARE_SUPPORT_UPDATE
    menu "Update Configuration"
        comment "Config Update"
        osource  "middleware/utils/update/Kconfig"
    endmenu
    endif
```

## middleware/utils/at/Kconfig
```kconfig
#===============================================================================
# @brief    Kconfig file.
# Copyright (c) HiSilicon (Shanghai) Technologies Co., Ltd. 2022-2023. All rights reserved.
#===============================================================================
config AT_SUPPORT_PLT
    bool
    prompt "platform at command"
    default n
    help
        This option means at support plt.

if AT_SUPPORT_PLT
menu "Config AT CFBB"
    comment "Config AT CFBB"
    osource  "middleware/utils/at/at/Kconfig"
endmenu
endif
```

## middleware/utils/at/at/Kconfig
```kconfig
#===============================================================================
# @brief    Kconfig file.
# Copyright (c) HiSilicon (Shanghai) Technologies Co., Ltd. 2023-2024. All rights reserved.
#===============================================================================
config AT_SUPPORT_LOG
    bool
    prompt "AT_SUPPORT_LOG"
    default n
    help
        This option means at support log.

config AT_SUPPORT_CMD_ATTR
    bool
    prompt "AT_SUPPORT_CMD_ATTR"
    default n
    help
        This option means at support cmd attr.

config AT_SUPPORT_ASYNCHRONOUS
    bool
    prompt "AT_SUPPORT_ASYNCHRONOUS"
    default n
    help
        This option means at support asynchronous.

config AT_SUPPORT_NOTIFY_REPORT
    bool
    prompt "AT_SUPPORT_NOTIFY_REPORT"
    default n
    help
        This option means at support notify report.

config AT_SUPPORT_ZDIAG
    bool
    prompt "AT_SUPPORT_ZDIAG"
    default n
    help
        This option means at support zdiag invocation.
```

## middleware/utils/dfx/Kconfig
```kconfig
#===============================================================================
# @brief    Kconfig file.
# Copyright (c) HiSilicon (Shanghai) Technologies Co., Ltd. 2023-2023. All rights reserved.
#===============================================================================
config DFX_SUPPORT_USERS_PRINT
    bool
    prompt "ENABLE USER TO REGISTER LOG API."
    default y
    depends on MIDDLEWARE_SUPPORT_DFX
config DFX_SUPPORT_PRINT
    bool
    prompt "dfx print with level limit"
    default n
    depends on MIDDLEWARE_SUPPORT_DFX
```

## middleware/utils/update/Kconfig
```kconfig
#===============================================================================
# @brief    Kconfig file.
# Copyright (c) HiSilicon (Shanghai) Technologies Co., Ltd. 2024-2024. All rights reserved.
#===============================================================================
config BT_UPG_ENABLE
    bool
    prompt "ENABLE BT UPG."
    default n
    depends on MIDDLEWARE_SUPPORT_UPDATE

config SLE_UPG_ENABLE
    bool
    prompt "ENABLE SLE UPG."
    default n
    depends on MIDDLEWARE_SUPPORT_UPDATE
```

## protocol/Kconfig
```kconfig
#===============================================================================
# @brief    Kconfig file.
# Copyright (c) HiSilicon (Shanghai) Technologies Co., Ltd. 2023-2023. All rights reserved.
#===============================================================================
menu "bt_host"
    comment "Config bluetooth."
    osource "protocol/bt/host/Kconfig"
endmenu

menu "bt_controller"
    comment "Config bluetooth."
    osource "protocol/bt/controller/Kconfig"
endmenu

menu "nfc"
    comment "Config nfc."
endmenu

menu "wifi"
    comment "Config wifi."
endmenu

config RADAR_SERVICE
    bool
    prompt "Enable Radar."
    default n
    help
        This option means support Radar.

if RADAR_SERVICE
menu "radar"
    comment "Config radar."
    osource "protocol/radar/plat/Kconfig"
endmenu
endif
```
