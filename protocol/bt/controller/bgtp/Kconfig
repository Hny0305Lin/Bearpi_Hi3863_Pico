## protocol/bt/controller/bgtp/Kconfig
```kconfig
#===============================================================================
# @brief    Kconfig file.
# Copyright (c) HiSilicon (Shanghai) Technologies Co., Ltd. 2023-2023. All rights reserved.
#===============================================================================

config USING_BLE_LEGACY_ADV_V1
    bool
    prompt "Using ble legacy adv v1."
    default n

config USING_BLE_ADV_EXTENDED_ADV_V1
    bool
    prompt "Using ble extended adv v1."
    default n

config USING_BLE_EXT_SECONARY_ADV_V1
    bool
    prompt "Using ble ext seconary adv v1."
    default n
    depends on USING_BLE_ADV_EXTENDED_ADV_V1

config USING_BLE_PERIODIC_ADV_V1
    bool
    prompt "Using ble periodic adv v1."
    default n
    depends on USING_BLE_ADV_EXTENDED_ADV_V1 && USING_BLE_EXT_SECONARY_ADV_V1

config USING_BLE_LEGACY_SCAN_V1
    bool
    prompt "Using ble legacy scan v1."
    default n

config USING_BLE_EXTENDED_SCAN_V1
    bool
    prompt "Using ble extended scan v1."
    default n

config USING_BLE_PERIODIC_SYNC_V1
    bool
    prompt "Using ble periodic sync v1."
    default n
    depends on USING_BLE_EXTENDED_SCAN_V1

config USING_BLE_LEGACY_INITIATE_V1
    bool
    prompt "Using ble legacy initiate v1."
    default n

config USING_BLE_EXTENDED_INITIATE_V1
    bool
    prompt "Using ble extended initiate v1."
    default n

config USING_BLE_PWR_CTRL_V1
    bool
    prompt "Using ble power control v1."
    default n

config USING_BLE_TEST_MODE_V1
    bool
    prompt "Using ble test mode v1."
    default n
```

## protocol/bt/host/Kconfig
```kconfig
#===============================================================================
# @brief    Kconfig file.
# Copyright (c) HiSilicon (Shanghai) Technologies Co., Ltd. 2023-2023. All rights reserved.
#===============================================================================
config AT_BLE
    bool
    prompt "Support AT BLE function."
    default y

if AT_BLE
menu "AT_BLE"
    comment "Config bluetooth host AT BLE."
    osource "protocol/bt/host/bt/dft/Kconfig"
endmenu
endif

config AT_GLE
    bool
    prompt "Support AT GLE function."
    default y

if AT_GLE
menu "AT_GLE"
    comment "Config bluetooth host AT GLE."
    osource "protocol/bt/host/gle/dft/Kconfig"
endmenu
endif

menu "FEATURE_GLE"
    comment "Config bluetooth host GLE feature."
    osource "protocol/bt/host/gle/Kconfig"
endmenu
```

## protocol/bt/host/gle/Kconfig
```kconfig
#===============================================================================
# @brief    SLE feature config.
# Copyright (c) HiSilicon (Shanghai) Technologies Co., Ltd. 2023-2023. All rights reserved.
#===============================================================================
config FEATURE_GLE_LOW_LATENCY
    bool
    prompt "Using gle low latency feature."
    default n

config FEATURE_GLE_HADM
    bool
    prompt "Using gle hadm feature."
    default n
```

## protocol/radar/plat/Kconfig
```kconfig
#===============================================================================
# @brief    Kconfig file.
# Copyright (c) HiSilicon (Shanghai) Technologies Co., Ltd. 2023-2023. All rights reserved.
#===============================================================================
config RADAR_DBG
    bool
    prompt "Enable Radar Dbg."
    default n
    help
        This option means support Radar Dbg.

config RADAR_AI
    bool
    prompt "Enable Radar AI."
    default n
    help
        This option means support Radar AI.

config RADAR_MFG
    bool
    prompt "Enable Radar MFG."
    default n
    help
        This option means support Radar MFG.

config RADAR_MIPS
    bool
    prompt "Enable Radar MIPS."
    default n
    help
        This option means support Radar MIPS.
```

## test/Kconfig
```kconfig
#===============================================================================
# @brief    Kconfig file.
# Copyright (c) HiSilicon (Shanghai) Technologies Co., Ltd. 2022-2022. All rights reserved.
#===============================================================================
config TEST_SUPPORT_TESTSUITE
    bool
    prompt "TESTSUITE"
    default y
    help
        This option means support testsuite.

if TEST_SUPPORT_TESTSUITE
menu "Testsuite Configuration"
    comment "Config Testsuite"
    osource  "test/common/testsuite/Kconfig"
    osource  "test/platform/testsuite/Kconfig"
endmenu
endif
```

## test/common/testsuite/Kconfig
```kconfig
#===============================================================================
# @brief    Kconfig file.
# Copyright (c) HiSilicon (Shanghai) Technologies Co., Ltd. 2022-2022. All rights reserved.
#===============================================================================
config TEST_SUITE_FUNCTIONS_MAX_FUNCS
    int
    prompt "number of testsuite max function"
    range 1 300
    default 200
    depends on TEST_SUPPORT_TESTSUITE

config TEST_CONSOLE_HISTORY_LEN
    int
    prompt "number of test command buffer size"
    range 0 10
    default 10
    depends on TEST_SUPPORT_TESTSUITE

config TEST_SUITE_TASK_STACK_SIZE
    hex
    prompt "number of test suit task stack size"
    range 0 0x4000
    default 0x800
    depends on TEST_SUPPORT_TESTSUITE
```
